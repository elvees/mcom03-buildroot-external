## package/mcom03-mali-vpu-libs/Config.in
```kconfig
config BR2_PACKAGE_MCOM03_MALI_VPU_LIBS
	bool "mcom03-mali-vpu-libs"
	select BR2_PACKAGE_HAS_LIBOPENMAX
	select BR2_PACKAGE_JPEG
	select BR2_PACKAGE_JPEG_TURBO
	select BR2_PACKAGE_MALI_VPU_KERN
	help
	  Linux library binaries for Mali VPU engine.

if BR2_PACKAGE_MCOM03_MALI_VPU_LIBS

config BR2_PACKAGE_PROVIDES_LIBOPENMAX
	default "mcom03-mali-vpu-libs"

endif
```

## package/mcom03-rogue-libs/Config.in
```kconfig
config BR2_PACKAGE_MCOM03_ROGUE_LIBS
	bool "mcom03-rogue-libs"
	depends on BR2_TOOLCHAIN_HAS_THREADS
	select BR2_PACKAGE_MESA3D
	select BR2_PACKAGE_LIBDRM
	select BR2_PACKAGE_MCOM03_ROGUE_MODULES
	select BR2_PACKAGE_HOST_PYTHON
	select BR2_PACKAGE_HOST_FLEX
	select BR2_PACKAGE_HOST_BISON
	select BR2_PACKAGE_HAS_LIBGLES
	select BR2_PACKAGE_HAS_LIBOPENCL
	select BR2_PACKAGE_LIBXML2
	select BR2_PACKAGE_MESA3D_DRI_DRIVER_PVR
	select BR2_PACKAGE_MESA3D_OPENGL_EGL
	help
	  User space libraries for MCom-03 PowerVR Rogue GPU.

if BR2_PACKAGE_MCOM03_ROGUE_LIBS

config BR2_PACKAGE_MCOM03_ROGUE_LIBS_OFFSCREEN_TESTS
	bool "off-screen tests"
	help
	  By default tests are on-screen. It can lead to
	  difficult GPU testing if dislpay not available.
	  Off-screen tests are more suitable for this.

config BR2_PACKAGE_MCOM03_ROGUE_LIBS_DEBUG
	bool "debug build"
	help
	  Useful for testing. If some tests fail this option
	  should be enabled.

config BR2_PACKAGE_MCOM03_ROGUE_LIBS_PDUMP
	bool "pdump build"
	help
	  PDump is used for snapshoting and playing back the
	  applications.

endif

if BR2_PACKAGE_MCOM03_ROGUE_LIBS

config BR2_PACKAGE_PROVIDES_LIBGLES
	default "mcom03-rogue-libs"

config BR2_PACKAGE_PROVIDES_LIBOPENCL
	default "mcom03-rogue-libs"

endif
```

## package/mcom03-rogue-modules/Config.in
```kconfig
config BR2_PACKAGE_MCOM03_ROGUE_MODULES
	bool "mcom03-rogue-modules"
	help
	  Kernel space driver for MCom-03 PowerVR Rogue GPU.

if BR2_PACKAGE_MCOM03_ROGUE_MODULES
config BR2_PACKAGE_MCOM03_ROGUE_MODULES_DEBUG
	bool "debug build"
	help
	  Useful for testing. If some tests fail this option
	  should be enabled.

config BR2_PACKAGE_MCOM03_ROGUE_MODULES_PDUMP
	bool "pdump build"
	help
	  PDump is used for snapshoting and playing back the
	  applications.

config BR2_PACKAGE_MCOM03_ROGUE_MODULES_DEVFREQ_PARENT
	bool "control GPU clock via PLL"
	help
	  Enable GPU clock control via PLL. Used for debugging
	  purposes.
endif
```

## package/mcom03-sbl-tl/Config.in
```kconfig
config BR2_PACKAGE_MCOM03_SBL_TL
	bool "mcom03-sbl-tl"
	help
	  The Trusted Secondary Bootloader is responsible for
	  verifying and loading secure boot images (sbimg).

if BR2_PACKAGE_MCOM03_SBL_TL

config BR2_PACKAGE_MCOM03_SBL_TL_TOOLCHAIN
	string "Toolchain"
	help
	  Path to the toolchain file to cross-compile
	  sbl-tl with.

config BR2_PACKAGE_MCOM03_SBL_TL_ADDITIONAL_VARIABLES
	string "Additional sbl-tl build variables"
	help
	  Additional parameters for the sbl-tl build
	  E.G. 'WDT_ENABLE=y DEBUG=y'

config BR2_PACKAGE_MCOM03_SBL_TL_REPO_VERSION
	string "Repository version"
	default archiveVideoCam_Ph5
	help
	  Revision to use in the typical format used by Git
	  E.G. a sha id, a tag, ..

endif
```

## package/mcom03-sbl/Config.in
```kconfig
config BR2_PACKAGE_MCOM03_SBL
	bool "mcom03-sbl"
	depends on BR2_PACKAGE_DDRINIT
	depends on BR2_TARGET_ARM_TRUSTED_FIRMWARE
	depends on BR2_TARGET_UBOOT_INSTALL_DTB
	help
	  Second bootloader for MCom-03.

comment "MCom-03 SBL needs ddrinit, TF-A and U-Boot to be built"
	depends on !BR2_PACKAGE_DDRINIT || !BR2_TARGET_ARM_TRUSTED_FIRMWARE || \
	!BR2_TARGET_UBOOT_INSTALL_DTB

if BR2_PACKAGE_MCOM03_SBL

config BR2_PACKAGE_MCOM03_SBL_REPO_VERSION
	string "Repository version"
	default master
	help
	  Revision to use in the typical format used by Git
	  E.G. a sha id, a tag, ..

config BR2_PACKAGE_MCOM03_SBL_RECOVERY_ENABLE
	bool "Enable recovery support"
	help
	  Allow to load recovery image

config BR2_PACKAGE_MCOM03_SBL_SBIMG_MAKE_RECOVERY
	bool "Make recovery SBIMG"
	help
	  Only make recovery SBIMG.

choice
	prompt "Select the type of security of SBIMG"

config BR2_PACKAGE_MCOM03_SBL_SBIMG_SEC_TYPE_ENC
	bool "enc+sign"
	help
	  Make SBIMG with signed and encrypted binary
	  components.

config BR2_PACKAGE_MCOM03_SBL_SBIMG_SEC_TYPE_SIGN
	bool "sign"
	help
	  Make SBIMG with signed binary components.

config BR2_PACKAGE_MCOM03_SBL_SBIMG_SEC_TYPE_NONE
	bool "none"
	help
	  Make SBIMG with binary components only.

endchoice

config BR2_PACKAGE_MCOM03_SBL_SBIMG_SEC_TYPE
	string
	default "enc"  if BR2_PACKAGE_MCOM03_SBL_SBIMG_SEC_TYPE_ENC
	default "sign" if BR2_PACKAGE_MCOM03_SBL_SBIMG_SEC_TYPE_SIGN
	default "none" if BR2_PACKAGE_MCOM03_SBL_SBIMG_SEC_TYPE_NONE

if BR2_PACKAGE_MCOM03_SBL_SBIMG_SEC_TYPE_SIGN || BR2_PACKAGE_MCOM03_SBL_SBIMG_SEC_TYPE_ENC

config BR2_PACKAGE_MCOM03_SBL_SBIMG_CERTS_TAR
	string "PATH to the archive with SBIMG certificates"
	default "$(BR2_EXTERNAL_MCOM03_PATH)/board/elvees/sbl-sbimg-certs.tar.gz"
	help
	  PATH to TAR archive with certificates that are required
	  for making signed and encrypted SBIMG.

config BR2_PACKAGE_MCOM03_SBL_FIT_CERTS_TAR
	string "PATH to the archive with FIT keys and certificates"
	default "$(BR2_EXTERNAL_MCOM03_PATH)/board/elvees/uboot-fit-certs.tar.gz"
	help
	  PATH to TAR archive with certificates that are required
	  for making signed FIT.

config BR2_PACKAGE_MCOM03_SBL_FIT_KEY_NAME
	string "The key name"
	default "root"
	help
	  This defines a private key file <key_name>.key for use
	  with signing, and a certificate <key_name>.crt (containing
	  the public key) for use with verification. The name is the
	  value of ‘key-name-hint’ property of the signature node in
	  FIT configuration and when embedded it into U-Boot device
	  tree.

config BR2_PACKAGE_MCOM03_SBL_FIT_SIGN_ALGO
	string "Signing algorithm name"
	default "sha256,rsa3072"
	help
	  Supported algorithm and their value sizes see at:
	  https://docs.u-boot.org/en/latest/usage/fit/source_file_format.html#fit-algorithm

endif

if BR2_PACKAGE_MCOM03_SBL_SBIMG_SEC_TYPE_ENC

config BR2_PACKAGE_MCOM03_SBL_SBIMG_ENC_DSN
	string "DSN"
	help
	  Device Serial Number (32 бита) <0x...>

config BR2_PACKAGE_MCOM03_SBL_SBIMG_ENC_DUK
	string "DUK"
	help
	  Device Unique Key (128 бит) <0x...>

config BR2_PACKAGE_MCOM03_SBL_SBIMG_ENC_KEY
	string "Encryption Key"
	help
	  Encryption Key (128 бит) <0x...>

endif

config BR2_PACKAGE_MCOM03_SBL_ADDITIONAL_VARIABLES
	string "Additional sbl build variables"
	help
	  Additional parameters for the sbl build
	  E.G. '-DWDT_ENABLE=y -DDEBUG=y'

endif
```

## package/mcom03-tl-common/Config.in
```kconfig
config BR2_PACKAGE_MCOM03_TL_COMMON
	bool "mcom03-tl-common"
	help
	  The package setups and provides the operation
	  of the service subsystem and trusted services.

if BR2_PACKAGE_MCOM03_TL_COMMON

config BR2_PACKAGE_MCOM03_TL_COMMON_INSTALL_SRC
	bool "Build from source code"

config BR2_PACKAGE_MCOM03_TL_COMMON_TOOLCHAIN
	string "Toolchain"
	help
	  Path to the toolchain file to cross-compile
	  tl-common with.

config BR2_PACKAGE_MCOM03_TL_COMMON_ADDITIONAL_VARIABLES
	string "Additional tl-common build variables"
	help
	  Additional parameters for the tl-common build
	  E.G. 'WDT_ENABLE=y DEBUG=y'

config BR2_PACKAGE_MCOM03_TL_COMMON_REPO_VERSION
	string "Repository version"
	default archiveVideoCam_Ph5
	help
	  Revision to use in the typical format used by Git
	  E.G. a sha id, a tag, ..

endif
```

## package/mcom03-tl-core/Config.in
```kconfig
config BR2_PACKAGE_MCOM03_TL_CORE
	bool "mcom03-tl-core"
	help
	  The package setups and provides the operation
	  of the service subsystem and trusted services.

if BR2_PACKAGE_MCOM03_TL_CORE

config BR2_PACKAGE_MCOM03_TL_CORE_INSTALL_SRC
	bool "Build from source code"

config BR2_PACKAGE_MCOM03_TL_CORE_TOOLCHAIN
	string "Toolchain"
	help
	  Path to the toolchain file to cross-compile
	  tl-core with.

config BR2_PACKAGE_MCOM03_TL_CORE_ADDITIONAL_VARIABLES
	string "Additional tl-core build variables"
	help
	  Additional parameters for the tl-core build
	  E.G. 'WDT_ENABLE=y DEBUG=y'

config BR2_PACKAGE_MCOM03_TL_CORE_REPO_VERSION
	string "Repository version"
	default master
	help
	  Revision to use in the typical format used by Git
	  E.G. a sha id, a tag, ..

endif
```

## package/mcom03-tl-sbimg/Config.in
```kconfig
config BR2_PACKAGE_MCOM03_TL_SBIMG
	bool "mcom03-tl-sbimg"
	depends on BR2_PACKAGE_DDRINIT
	depends on BR2_PACKAGE_MCOM03_SBL
	depends on BR2_PACKAGE_MCOM03_SBL_TL
	depends on BR2_PACKAGE_MCOM03_TL_CORE
	depends on BR2_TARGET_ARM_TRUSTED_FIRMWARE
	depends on BR2_TARGET_UBOOT
	help
	  Make secure boot image (SBIMG).

comment "MCom-03 TL-SBIMG needs ddrinit, mcom03-sbl, mcom03-sbl-tl, mcom03-tl-core, arm-trusted-firmware, uboot"
	depends on !BR2_PACKAGE_DDRINIT || \
		!BR2_PACKAGE_MCOM03_SBL || \
		!BR2_PACKAGE_MCOM03_SBL_TL || \
		!BR2_PACKAGE_MCOM03_TL_CORE || \
		!BR2_TARGET_ARM_TRUSTED_FIRMWARE || \
		!BR2_TARGET_UBOOT

if BR2_PACKAGE_MCOM03_TL_SBIMG

config BR2_PACKAGE_MCOM03_TL_SBIMG_REPO_VERSION
	string "Repository version"
	default master
	help
	  Revision to use in the typical format used by Git
	  E.G. a sha id, a tag, ..

config BR2_PACKAGE_MCOM03_TL_SBIMG_CERTS_URL
	string "URL to tar with certificates"
	help
	  Link to certificates required for making signed
	  and encrypted SBIMG.

config BR2_PACKAGE_MCOM03_TL_SBIMG_MAKE_RECOVERY
	bool "Make recovery SBIMG"
	help
	  Only make recovery SBIMG.

choice
	prompt "Select the type of security of SBIMG"

config BR2_PACKAGE_MCOM03_TL_SBIMG_SEC_TYPE_ENC
	bool "enc+sign"
	help
	  Make SBIMG with signed and encrypted binary
	  components.

config BR2_PACKAGE_MCOM03_TL_SBIMG_SEC_TYPE_SIGN
	bool "sign"
	help
	  Make SBIMG with signed binary components.

endchoice

config BR2_PACKAGE_MCOM03_TL_SBIMG_SEC_TYPE
	string
	default "enc"	if BR2_PACKAGE_MCOM03_TL_SBIMG_SEC_TYPE_ENC
	default "sign"  if BR2_PACKAGE_MCOM03_TL_SBIMG_SEC_TYPE_SIGN

if BR2_PACKAGE_MCOM03_TL_SBIMG_SEC_TYPE_ENC

config BR2_PACKAGE_MCOM03_TL_SBIMG_ENC_DSN
	string "DSN"
	help
	  Device Serial Number (32 бита) <0x...>

config BR2_PACKAGE_MCOM03_TL_SBIMG_ENC_DUK
	string "DUK"
	help
	  Device Unique Key (128 бит) <0x...>

config BR2_PACKAGE_MCOM03_TL_SBIMG_ENC_KEY
	string "Encryption Key"
	help
	  Encryption Key (128 бит) <0x...>

endif

endif
```

## package/mcom03-vpu-libs-bin/Config.in
```kconfig
config BR2_PACKAGE_MCOM03_VPU_LIBS_BIN
	bool "mcom03-vpu-libs-bin"
	select BR2_PACKAGE_HAS_LIBOPENMAX
	select BR2_PACKAGE_JPEG
	select BR2_PACKAGE_JPEG_TURBO
	select BR2_PACKAGE_MALI_VPU_KERN
	help
	  Linux library binaries for Mali VPU engine.

if BR2_PACKAGE_MCOM03_VPU_LIBS_BIN

config BR2_PACKAGE_PROVIDES_LIBOPENMAX
	default "mcom03-vpu-libs-bin"

endif
```

## package/mcom03-vpu-libs/Config.in
```kconfig
config BR2_PACKAGE_MCOM03_VPU_LIBS
	bool "mcom03-vpu-libs"
	select BR2_PACKAGE_HAS_LIBOPENMAX
	select BR2_PACKAGE_JPEG
	select BR2_PACKAGE_JPEG_TURBO
	select BR2_PACKAGE_MALI_VPU_KERN
	help
	  Linux user space driver for Mali VPU engine.

if BR2_PACKAGE_MCOM03_VPU_LIBS

config BR2_PACKAGE_PROVIDES_LIBOPENMAX
	default "mcom03-vpu-libs"

endif
```

## package/mcom03-vpu-modules/Config.in
```kconfig
config BR2_PACKAGE_MCOM03_VPU_MODULES
	bool "mcom03-vpu-modules"
	help
	  Linux kernel space driver for Mali VPU engine.

if BR2_PACKAGE_MCOM03_VPU_MODULES

config BR2_PACKAGE_MCOM03_VPU_MODULES_VERSION
	string "version"
	default "master"
	help
	  Version of VPU driver

config BR2_PACKAGE_MCOM03_VPU_MODULES_DEBUG
	bool "driver debug"
	help
	  This enabled debug output for the Mali VPU driver.

config BR2_PACKAGE_MCOM03_VPU_MODULES_DISABLE_WDOG
	bool "disable watchdog"
	help
	  Disable the watchdog that detects frozen video sessions.

choice
	prompt "Choose power saving mode"
config BR2_PACKAGE_MCOM03_VPU_MODULES_DVFS
	bool "Use DVFS"
config BR2_PACKAGE_MCOM03_VPU_MODULES_CLOCK_GATING
	bool "Use HW clock gating"
endchoice

endif
```

## package/powervr-rogue-libs/Config.in
```kconfig
config BR2_PACKAGE_POWERVR_ROGUE_LIBS
	bool "powervr-rogue-libs"
	depends on BR2_TOOLCHAIN_HAS_THREADS
	select BR2_PACKAGE_LIBDRM
	select BR2_PACKAGE_POWERVR_ROGUE_KERN
	select BR2_PACKAGE_HAS_LIBEGL
	select BR2_PACKAGE_HAS_LIBGLES
	help
	  User space driver for PowerVR Rogue GPU.

if BR2_PACKAGE_POWERVR_ROGUE_LIBS

config BR2_PACKAGE_POWERVR_ROGUE_LIBS_OFFSCREEN_TESTS
	bool "off-screen tests"
	help
	  By default tests are on-screen. It can lead to
	  difficult GPU testing if dislpay not available.
	  Off-screen tests are more suitable for this.

config BR2_PACKAGE_POWERVR_ROGUE_LIBS_DEBUG
	bool "debug build"
	help
	  Useful for testing. If some tests fail this option
	  should be enabled.

config BR2_PACKAGE_POWERVR_ROGUE_LIBS_PDUMP
	bool "pdump build"
	help
	  PDump is used for snapshoting and playing back the
	  applications.

config BR2_PACKAGE_PROVIDES_LIBEGL
	default "powervr-rogue-libs"

config BR2_PACKAGE_PROVIDES_LIBGLES
	default "powervr-rogue-libs"

endif
```

## package/rtl-test-stop/Config.in
```kconfig
config BR2_PACKAGE_RTL_TEST_STOP
	bool "rtl-test-stop"
	select BR2_TARGET_ROOTFS_INITRAMFS
	help
	  Provides a test stop marker for a RTL sumulator. The test will
	  be successfuly completed if the RTL test observes a magic
	  value in a magic RAM address. The package creates a tiny
	  initramfs and replaces an initramfs which is generated by the
	  Buildroot.
	  This package should be used only on RTL.

if BR2_PACKAGE_RTL_TEST_STOP
config BR2_PACKAGE_RTL_TEST_STOP_MAGIC_ADDR
	string "magic address"
	default "0xF0001FF0"
	help
	  RAM address where the RTL test expects a magic value.

config BR2_PACKAGE_RTL_TEST_STOP_MAGIC_VALUE
	string "magic value"
	default "0x12345678"
	help
	  Value which will be written to a magic address when
	  the Linux will start userspace.
endif
```

## package/sensor-phy/Config.in
```kconfig
config BR2_PACKAGE_MCOM03_SENSOR_PHY
	bool "Sensor-phy"
	depends on BR2_LINUX_KERNEL
	help
	  Kernel driver for Synopsys MIPI DPHY RX control
```

## toolchain/toolchain-mipsel-elvees-elf32/Config.in
```kconfig
config BR2_HOST_TOOLCHAIN_MIPSEL_ELVEES_ELF32
	bool
	default y
	help
	  ELVEES MIPS32 toolchain which works around some errata for
	  MCom-03 MIPS
```
