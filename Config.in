## Config.in
```kconfig
comment "MCom-03 support needs AArch64 architecture"
	depends on !BR2_aarch64

if BR2_aarch64

source "$BR2_EXTERNAL_MCOM03_PATH/package/bootrom-tools/Config.in"
source "$BR2_EXTERNAL_MCOM03_PATH/package/mcom03-baremetal-tools/Config.in"
source "$BR2_EXTERNAL_MCOM03_PATH/package/mcom03-sbl/Config.in"
source "$BR2_EXTERNAL_MCOM03_PATH/package/mcom03-sbl-tl/Config.in"
source "$BR2_EXTERNAL_MCOM03_PATH/package/mcom03-tl-sbimg/Config.in"

config BR2_MCOM03_DDRINIT_DTB_MAP
	string "List of ddrinit-dtb pairs"
	default "$(BR2_EXTERNAL_MCOM03_PATH)/board/elvees/ddrinit-dtb-map.txt"
	help
	  List must have the following format:
	  "ddrinit1:dtb1 ddrinit2:dtb2".

comment "MCom-03 support needs MCom-03-specific Linux kernel to be built"
	depends on !BR2_LINUX_KERNEL

if BR2_LINUX_KERNEL

source "$BR2_EXTERNAL_MCOM03_PATH/package/acptest/Config.in"
source "$BR2_EXTERNAL_MCOM03_PATH/package/gst-felix/Config.in"
source "$BR2_EXTERNAL_MCOM03_PATH/package/linux-starter/Config.in"
source "$BR2_EXTERNAL_MCOM03_PATH/package/mcom03-dmabuf-exporter/Config.in"
source "$BR2_EXTERNAL_MCOM03_PATH/package/mcom03-felix/Config.in"
source "$BR2_EXTERNAL_MCOM03_PATH/package/mcom03-linux-utils/Config.in"
source "$BR2_EXTERNAL_MCOM03_PATH/package/mcom03-linux-utils-python/Config.in"
source "$BR2_EXTERNAL_MCOM03_PATH/package/mcom03-vpu-libs/Config.in"
source "$BR2_EXTERNAL_MCOM03_PATH/package/mcom03-vpu-modules/Config.in"
source "$BR2_EXTERNAL_MCOM03_PATH/package/mcom03-rogue-libs/Config.in"
source "$BR2_EXTERNAL_MCOM03_PATH/package/mcom03-rogue-modules/Config.in"
source "$BR2_EXTERNAL_MCOM03_PATH/package/rtl-test-stop/Config.in"
source "$BR2_EXTERNAL_MCOM03_PATH/package/sensor-phy/Config.in"

endif

config BR2_ELVEES_BINARY_PACKAGES_SITE
	string "URL for site with private binaries"
	default "http://dist.elvees.com/mcom03/packages"
	help
	  URL with published private binaries.

source "$BR2_EXTERNAL_MCOM03_PATH/toolchain/toolchain-mipsel-elvees-elf32/Config.in"

endif
```

## configs/mcom03_defconfig
```kconfig
BR2_aarch64=y
BR2_PACKAGE_HOST_LINUX_HEADERS_CUSTOM_5_10=y
BR2_TOOLCHAIN_BUILDROOT_CXX=y
BR2_GCC_ENABLE_OPENMP=y
BR2_OPTIMIZE_3=y
BR2_INIT_SYSTEMD=y
BR2_SYSTEM_BIN_SH_BASH=y
# BR2_TARGET_GENERIC_GETTY is not set
BR2_ROOTFS_OVERLAY="${BR2_EXTERNAL_MCOM03_PATH}/overlay/elvees/common"
BR2_ROOTFS_POST_BUILD_SCRIPT="${TARGET_DIR}/usr/bin/extlinux-gen"
BR2_LINUX_KERNEL=y
BR2_LINUX_KERNEL_CUSTOM_GIT=y
BR2_LINUX_KERNEL_CUSTOM_REPO_URL="https://review.elvees.com/mcom03/linux"
BR2_LINUX_KERNEL_CUSTOM_REPO_VERSION="mcom03-5.10.y"
BR2_LINUX_KERNEL_DEFCONFIG="mcom03"
BR2_LINUX_KERNEL_DTS_SUPPORT=y
BR2_LINUX_KERNEL_INTREE_DTS_NAME="elvees/mcom03-*"
BR2_LINUX_KERNEL_DTB_KEEP_DIRNAME=y
BR2_LINUX_KERNEL_INSTALL_TARGET=y
BR2_LINUX_KERNEL_NEEDS_HOST_OPENSSL=y
BR2_PACKAGE_LINUX_TOOLS_GPIO=y
BR2_PACKAGE_LINUX_TOOLS_PCI=y
BR2_PACKAGE_LINUX_TOOLS_PERF=y
BR2_PACKAGE_LINUX_TOOLS_PERF_TUI=y
BR2_PACKAGE_LINUX_TOOLS_SELFTESTS=y
BR2_PACKAGE_BUSYBOX_CONFIG="${BR2_EXTERNAL_MCOM03_PATH}/board/elvees/busybox.config"
BR2_PACKAGE_ALSA_UTILS_AMIXER=y
BR2_PACKAGE_ALSA_UTILS_SPEAKER_TEST=y
BR2_PACKAGE_FFMPEG_FFPLAY=y
BR2_PACKAGE_GST1_PLUGINS_BASE_PLUGIN_AUDIORATE=y
BR2_PACKAGE_GST1_PLUGINS_BASE_PLUGIN_VIDEOTESTSRC=y
BR2_PACKAGE_GST1_PLUGINS_BASE_LIB_OPENGL=y
BR2_PACKAGE_GST1_PLUGINS_GOOD_JPEG=y
BR2_PACKAGE_GST1_PLUGINS_GOOD_PNG=y
BR2_PACKAGE_GST1_PLUGINS_GOOD_PLUGIN_MULTIFILE=y
BR2_PACKAGE_GST1_PLUGINS_GOOD_PLUGIN_RTSP=y
BR2_PACKAGE_GST1_PLUGINS_BAD=y
BR2_PACKAGE_GST1_PLUGINS_BAD_PLUGIN_DEBUGUTILS=y
BR2_PACKAGE_GST1_PLUGINS_BAD_PLUGIN_JPEGFORMAT=y
BR2_PACKAGE_GST1_PLUGINS_BAD_PLUGIN_VIDEOPARSERS=y
BR2_PACKAGE_GST1_PLUGINS_BAD_PLUGIN_KMS=y
BR2_PACKAGE_GST1_INTERPIPE=y
BR2_PACKAGE_GST_OMX=y
BR2_PACKAGE_FIO=y
BR2_PACKAGE_RAMSPEED=y
BR2_PACKAGE_STRESS_NG=y
BR2_PACKAGE_TINYMEMBENCH=y
BR2_PACKAGE_DOSFSTOOLS=y
BR2_PACKAGE_DOSFSTOOLS_FATLABEL=y
BR2_PACKAGE_DOSFSTOOLS_FSCK_FAT=y
BR2_PACKAGE_DOSFSTOOLS_MKFS_FAT=y
BR2_PACKAGE_E2FSPROGS_DEBUGFS=y
BR2_PACKAGE_E2FSPROGS_E2IMAGE=y
BR2_PACKAGE_E2FSPROGS_E4DEFRAG=y
BR2_PACKAGE_E2FSPROGS_FUSE2FS=y
BR2_PACKAGE_E2FSPROGS_RESIZE2FS=y
BR2_PACKAGE_MTD_MKFSUBIFS=y
BR2_PACKAGE_MTD_SUMTOOL=y
BR2_PACKAGE_MTD_TESTS=y
BR2_PACKAGE_NFS_UTILS=y
BR2_PACKAGE_NFS_UTILS_NFSV4=y
BR2_PACKAGE_NFS_UTILS_RPC_LOCKD=y
BR2_PACKAGE_GLMARK2=y
BR2_PACKAGE_WESTON=y
BR2_PACKAGE_LINUX_FIRMWARE=y
BR2_PACKAGE_LINUX_FIRMWARE_LONTIUM=y
BR2_PACKAGE_LINUX_FIRMWARE_ATHEROS_10K_QCA9377=y
BR2_PACKAGE_LINUX_FIRMWARE_QUALCOMM_6174=y
BR2_PACKAGE_LINUX_FIRMWARE_RTL_RTW88=y
BR2_PACKAGE_LINUX_FIRMWARE_RTL_8169=y
BR2_PACKAGE_EVTEST=y
BR2_PACKAGE_GPSD=y
BR2_PACKAGE_GPSD_DEVICES="/dev/gnss0"
BR2_PACKAGE_HDPARM=y
BR2_PACKAGE_HWDATA=y
BR2_PACKAGE_I2C_TOOLS=y
BR2_PACKAGE_MDIO_TOOLS=y
BR2_PACKAGE_MEMTESTER=y
BR2_PACKAGE_PCIUTILS=y
BR2_PACKAGE_SMARTMONTOOLS=y
BR2_PACKAGE_UBOOT_TOOLS=y
BR2_PACKAGE_UBOOT_TOOLS_MCOM03_UTILS=y
BR2_PACKAGE_USBUTILS=y
BR2_PACKAGE_PYTHON3_SSL=y
BR2_PACKAGE_LIBDRM_INSTALL_TESTS=y
BR2_PACKAGE_LIBGPIOD_TOOLS=y
BR2_PACKAGE_LIBIIO=y
# BR2_PACKAGE_LIBIIO_XML_BACKEND is not set
# BR2_PACKAGE_LIBIIO_NETWORK_BACKEND is not set
# BR2_PACKAGE_LIBIIO_USB_BACKEND is not set
# BR2_PACKAGE_LIBIIO_SERIAL_BACKEND is not set
# BR2_PACKAGE_LIBIIO_IIOD is not set
BR2_PACKAGE_LIBIIO_TESTS=y
BR2_PACKAGE_LIBNFC=y
BR2_PACKAGE_LIBNFC_PN532_UART=y
BR2_PACKAGE_LIBNFC_EXAMPLES=y
BR2_PACKAGE_TINYXML2=y
BR2_PACKAGE_LINUX_PAM=y
BR2_PACKAGE_COLLECTD=y
BR2_PACKAGE_COLLECTD_CPU=y
BR2_PACKAGE_COLLECTD_CPUFREQ=y
BR2_PACKAGE_COLLECTD_DF=y
BR2_PACKAGE_COLLECTD_DISK=y
BR2_PACKAGE_COLLECTD_ETHSTAT=y
BR2_PACKAGE_COLLECTD_EXEC=y
BR2_PACKAGE_COLLECTD_INTERFACE=y
BR2_PACKAGE_COLLECTD_IRQ=y
BR2_PACKAGE_COLLECTD_MEMORY=y
BR2_PACKAGE_COLLECTD_PING=y
BR2_PACKAGE_COLLECTD_PROCESSES=y
BR2_PACKAGE_COLLECTD_SENSORS=y
BR2_PACKAGE_COLLECTD_UPTIME=y
BR2_PACKAGE_COLLECTD_GRAPHITE=y
BR2_PACKAGE_COLLECTD_NETWORK=y
BR2_PACKAGE_COLLECTD_WRITELOG=y
BR2_PACKAGE_BLUEZ5_UTILS=y
BR2_PACKAGE_BLUEZ5_UTILS_CLIENT=y
BR2_PACKAGE_BLUEZ5_UTILS_MONITOR=y
BR2_PACKAGE_BLUEZ5_UTILS_TOOLS=y
BR2_PACKAGE_BLUEZ5_UTILS_PLUGINS_AUDIO=y
BR2_PACKAGE_BLUEZ5_UTILS_PLUGINS_HID=y
BR2_PACKAGE_CAN_UTILS=y
BR2_PACKAGE_DHCPCD=y
BR2_PACKAGE_ETHTOOL=y
BR2_PACKAGE_IFMETRIC=y
BR2_PACKAGE_IPERF3=y
BR2_PACKAGE_IPROUTE2=y
BR2_PACKAGE_LINUXPTP=y
BR2_PACKAGE_LRZSZ=y
BR2_PACKAGE_MODEM_MANAGER_LIBQMI=y
BR2_PACKAGE_NETWORK_MANAGER=y
BR2_PACKAGE_NETWORK_MANAGER_TUI=y
BR2_PACKAGE_NETWORK_MANAGER_CLI=y
BR2_PACKAGE_NETWORK_MANAGER_MODEM_MANAGER=y
BR2_PACKAGE_NMAP=y
BR2_PACKAGE_NMAP_NCAT=y
BR2_PACKAGE_OPENSSH=y
BR2_PACKAGE_PHYTOOL=y
BR2_PACKAGE_RSYNC=y
BR2_PACKAGE_WGET=y
BR2_PACKAGE_WPA_SUPPLICANT=y
BR2_PACKAGE_WPA_SUPPLICANT_AUTOSCAN=y
BR2_PACKAGE_WPA_SUPPLICANT_WPS=y
BR2_PACKAGE_WPA_SUPPLICANT_WPA3=y
BR2_PACKAGE_WPA_SUPPLICANT_CLI=y
BR2_PACKAGE_WPA_SUPPLICANT_WPA_CLIENT_SO=y
BR2_PACKAGE_WPA_SUPPLICANT_PASSPHRASE=y
BR2_PACKAGE_WPA_SUPPLICANT_DBUS=y
BR2_PACKAGE_COREUTILS=y
BR2_PACKAGE_SYSTEMD_ANALYZE=y
BR2_PACKAGE_SYSTEMD_LOGIND=y
# BR2_PACKAGE_SYSTEMD_NETWORKD is not set
# BR2_PACKAGE_SYSTEMD_RESOLVED is not set
BR2_PACKAGE_UTIL_LINUX_HWCLOCK=y
BR2_PACKAGE_UTIL_LINUX_UUIDD=y
BR2_PACKAGE_NANO=y
BR2_TARGET_ROOTFS_TAR_GZIP=y
BR2_TARGET_ARM_TRUSTED_FIRMWARE=y
BR2_TARGET_ARM_TRUSTED_FIRMWARE_CUSTOM_GIT=y
BR2_TARGET_ARM_TRUSTED_FIRMWARE_CUSTOM_REPO_URL="ssh://gerrit.elvees.com:29418/mcom03/arm-trusted-firmware"
BR2_TARGET_ARM_TRUSTED_FIRMWARE_CUSTOM_REPO_VERSION="master"
BR2_TARGET_ARM_TRUSTED_FIRMWARE_PLATFORM="mcom03"
BR2_TARGET_ARM_TRUSTED_FIRMWARE_SSP=y
BR2_TARGET_GRUB2=y
BR2_TARGET_GRUB2_BUILTIN_MODULES_EFI="boot linux ext2 fat squash4 part_msdos part_gpt normal efi_gop echo search test"
BR2_TARGET_UBOOT=y
BR2_TARGET_UBOOT_BUILD_SYSTEM_KCONFIG=y
BR2_TARGET_UBOOT_CUSTOM_GIT=y
BR2_TARGET_UBOOT_CUSTOM_REPO_URL="ssh://gerrit.elvees.com:29418/mcom03/u-boot"
BR2_TARGET_UBOOT_CUSTOM_REPO_VERSION="mcom03"
BR2_TARGET_UBOOT_BOARD_DEFCONFIG="mcom03"
BR2_TARGET_UBOOT_INSTALL_DTB=y
BR2_TARGET_UBOOT_INSTALL_DTB_SUBDIR="uboot-dtb"
BR2_PACKAGE_HOST_ENVIRONMENT_SETUP=y
BR2_PACKAGE_HOST_UBOOT_TOOLS=y
BR2_PACKAGE_HOST_UBOOT_TOOLS_ENVIMAGE=y
BR2_PACKAGE_HOST_UBOOT_TOOLS_ENVIMAGE_SIZE="65536"
BR2_PACKAGE_AUDIO_TESTS=y
BR2_PACKAGE_DDRINIT=y
BR2_PACKAGE_DDRINIT_DEFCONFIGS="elvmc03smarc-r1.0 elvmc03smarc-r1.0:bootrom elvmc03smarc-r2.2.0 elvmc03smarc-r2.2.0:bootrom elvmc03smarc-r2.6.1 elvmc03smarc-r2.6.1:bootrom elvmc03smarc-r2.7.1 elvmc03smarc-r2.7.1:bootrom elvmc03smarc-r2.9.1 elvmc03smarc-r2.9.1:bootrom elvmc03smarc-r2.10.0 elvmc03smarc-r2.10.0:bootrom elvmc03smarc-r2.11.0 elvmc03smarc-r2.11.0:bootrom elvmc03smarc-r3.0.0 elvmc03smarc-r3.0.0:bootrom egwpm-r1.0 egwpm-r1.0:bootrom elvmc03-r2.2 elvmc03-r2.2:bootrom elvmc03q7-r1.0 elvmc03q7-r1.0:bootrom elvmc03q7-r2.1.1 elvmc03q7-r2.1.1:bootrom elvmc03q7-r2.8.1 elvmc03q7-r2.8.1:bootrom elvmc03q7-r2.11.1 elvmc03q7-r2.11.1:bootrom elvmc03ce-r2.4 elvmc03ce-r2.4:bootrom elvmc03ce-r2.5.0 elvmc03ce-r2.5.0:bootrom elvmc03ce-r2.8.1 elvmc03ce-r2.8.1:bootrom elvmc03ce-r2.11.0 elvmc03ce-r2.11.0:bootrom mcom03bub-r1.3.0 mcom03bub-r1.3.0:bootrom monoboard-r1.1.1 monoboard-r1.1.1:bootrom monoboard-r1.2.2 monoboard-r1.2.2:bootrom pico-itx-r2 pico-itx-r2:bootrom skifmp-v1.0 skifmp-v1.0:bootrom skifmsb-v2.0 skifmsb-v2.0:bootrom"
BR2_PACKAGE_DDRINIT_TOOLCHAIN="$(HOST_TOOLCHAIN_MIPSEL_ELVEES_ELF32_INSTALL_DIR)/bin/mipsel-elvees-elf-"
BR2_PACKAGE_DOOL=y
BR2_PACKAGE_ELVEES_ALSA_PREPARE=y
BR2_PACKAGE_ELVEES_COREMARK=y
BR2_PACKAGE_ELVEES_COREMARK_THREADS=4
BR2_PACKAGE_F3=y
BR2_PACKAGE_F3_EXTRA=y
BR2_PACKAGE_GRAPHENE=y
BR2_PACKAGE_GST_PLUGINS_EXAMPLES=y
BR2_PACKAGE_GST_PLUGINS_EXAMPLES_MULTI_RTSP_SERVER=y
BR2_PACKAGE_MEMTESTER_SIMPLE=y
BR2_PACKAGE_MIXBENCH_OPENCL=y
BR2_PACKAGE_MPMFLOPS=y
BR2_PACKAGE_NXP_WIFI_88W8987=y
BR2_PACKAGE_PYTHON_PARALLEL_TEST=y
BR2_PACKAGE_PYTHON_PYFDT=y
BR2_PACKAGE_TAR2DEV=y
BR2_PACKAGE_TAR2DEV_UEFI=y
BR2_PACKAGE_UART_LOOPBACK_TEST=y
BR2_PACKAGE_VULKAN_DEMOS=y
BR2_PACKAGE_VULKAN_DEMOS_WAYLAND=y
BR2_PACKAGE_VULKAN_DEMOS_ASSETS_LIST="${BR2_EXTERNAL_MCOM03_PATH}/board/elvees/vulkan-assets.list"
BR2_PACKAGE_DSP_COREMARK=y
BR2_PACKAGE_DSP_ELCORE50_LIBRARIES=y
BR2_PACKAGE_DSP_MEMTESTER=y
BR2_PACKAGE_ELCORECL_EXAMPLES=y
BR2_PACKAGE_ELCORECL_EXTRA=y
BR2_PACKAGE_ELCORENN_EXAMPLES=y
BR2_PACKAGE_MGDBSERVER=y
BR2_PACKAGE_PYTHON_ELCORECL=y
BR2_PACKAGE_PYTHON_ELCORENN=y
BR2_BINUTILS_ELCORE50=y
BR2_PACKAGE_HOST_BOOTROM_TOOLS=y
BR2_PACKAGE_MCOM03_BAREMETAL_TOOLS=y
BR2_PACKAGE_MCOM03_SBL=y
BR2_PACKAGE_MCOM03_SBL_SBIMG_SEC_TYPE_NONE=y
BR2_PACKAGE_GST_FELIX=y
BR2_PACKAGE_MCOM03_FELIX_LINUX_VERSION="5.10"
BR2_PACKAGE_MCOM03_LINUX_UTILS=y
BR2_PACKAGE_MCOM03_LINUX_UTILS_SET_HOSTNAME_SERVICE=y
BR2_PACKAGE_MCOM03_LINUX_UTILS_MONOBOARD=y
BR2_PACKAGE_MCOM03_LINUX_UTILS_WESTON=y
BR2_PACKAGE_MCOM03_LINUX_UTILS_PYTHON=y
BR2_PACKAGE_MCOM03_VPU_LIBS=y
BR2_PACKAGE_MCOM03_ROGUE_LIBS=y
```

## configs/mcom03bubpriv_defconfig
```kconfig
BR2_aarch64=y
BR2_OPTIMIZE_3=y
BR2_TOOLCHAIN_BUILDROOT_GLIBC=y
BR2_PACKAGE_HOST_LINUX_HEADERS_CUSTOM_4_19=y
BR2_GCC_VERSION_8_X=y
BR2_TOOLCHAIN_BUILDROOT_CXX=y
BR2_GCC_ENABLE_OPENMP=y
BR2_ROOTFS_DEVICE_CREATION_DYNAMIC_EUDEV=y
BR2_SYSTEM_BIN_SH_BASH=y
BR2_TARGET_GENERIC_GETTY_PORT="ttyS0"
BR2_ROOTFS_OVERLAY="${BR2_EXTERNAL_MCOM03_PATH}/overlay/elvees"
BR2_ROOTFS_POST_IMAGE_SCRIPT="support/scripts/genimage.sh"
BR2_ROOTFS_POST_SCRIPT_ARGS="-c ${BR2_EXTERNAL_MCOM03_PATH}/board/elvees/sd-image.cfg"
BR2_LINUX_KERNEL=y
BR2_LINUX_KERNEL_CUSTOM_GIT=y
BR2_LINUX_KERNEL_CUSTOM_REPO_URL="ssh://gerrit.elvees.com:29418/linux/kernel"
BR2_LINUX_KERNEL_CUSTOM_REPO_VERSION="mcom03"
BR2_LINUX_KERNEL_DEFCONFIG="mcom03"
BR2_LINUX_KERNEL_NEEDS_HOST_OPENSSL=y
BR2_PACKAGE_LINUX_TOOLS_GPIO=y
BR2_PACKAGE_LINUX_TOOLS_PERF=y
BR2_PACKAGE_LINUX_TOOLS_PERF_TUI=y
BR2_PACKAGE_LINUX_TOOLS_SELFTESTS=y
BR2_PACKAGE_BUSYBOX_CONFIG="${BR2_EXTERNAL_MCOM03_PATH}/board/elvees/busybox.config"
BR2_PACKAGE_BUSYBOX_SHOW_OTHERS=y
BR2_PACKAGE_FFMPEG_FFPLAY=y
BR2_PACKAGE_MPV=y
BR2_PACKAGE_FIO=y
BR2_PACKAGE_RAMSPEED=y
BR2_PACKAGE_TINYMEMBENCH=y
BR2_PACKAGE_BATS_CORE=y
BR2_PACKAGE_HDPARM=y
BR2_PACKAGE_I2C_TOOLS=y
BR2_PACKAGE_LIBDRM_INSTALL_TESTS=y
BR2_PACKAGE_TINYXML2=y
BR2_PACKAGE_DHCPCD=y
BR2_PACKAGE_IPERF3=y
BR2_PACKAGE_LRZSZ=y
BR2_PACKAGE_NMAP=y
BR2_PACKAGE_NMAP_NCAT=y
BR2_PACKAGE_OPENSSH=y
BR2_PACKAGE_COREUTILS=y
BR2_PACKAGE_NANO=y
BR2_TARGET_ROOTFS_EXT2=y
BR2_TARGET_ROOTFS_EXT2_4=y
BR2_TARGET_ROOTFS_EXT2_SIZE="1000M"
BR2_TARGET_ARM_TRUSTED_FIRMWARE=y
BR2_TARGET_ARM_TRUSTED_FIRMWARE_CUSTOM_GIT=y
BR2_TARGET_ARM_TRUSTED_FIRMWARE_CUSTOM_REPO_URL="ssh://gerrit.elvees.com:29418/mcom03/arm-trusted-firmware"
BR2_TARGET_ARM_TRUSTED_FIRMWARE_CUSTOM_REPO_VERSION="master"
BR2_TARGET_ARM_TRUSTED_FIRMWARE_PLATFORM="mcom03"
BR2_TARGET_UBOOT=y
BR2_TARGET_UBOOT_BUILD_SYSTEM_KCONFIG=y
BR2_TARGET_UBOOT_CUSTOM_GIT=y
BR2_TARGET_UBOOT_CUSTOM_REPO_URL="ssh://gerrit.elvees.com:29418/bootloader/u-boot"
BR2_TARGET_UBOOT_CUSTOM_REPO_VERSION="mcom03"
BR2_TARGET_UBOOT_BOARD_DEFCONFIG="mcom03bub"
BR2_TARGET_UBOOT_ENVIMAGE=y
BR2_TARGET_UBOOT_ENVIMAGE_SIZE="65536"
BR2_PACKAGE_HOST_CMAKE=y
BR2_PACKAGE_HOST_DOSFSTOOLS=y
BR2_PACKAGE_HOST_GENIMAGE=y
BR2_PACKAGE_HOST_MTOOLS=y
BR2_PACKAGE_DDRINIT=y
BR2_PACKAGE_DDRINIT_DEFCONFIGS="mcom03bub mcom03bubjtag"
BR2_PACKAGE_DDRINIT_TOOLCHAIN="$(TARGET_CROSS)"
BR2_PACKAGE_PYTHON_PARALLEL_TEST=y
BR2_PACKAGE_DOOL=y
BR2_PACKAGE_MALI_VPU_LIBS=y
BR2_PACKAGE_MCOM03_ROGUE_LIBS=y
BR2_PACKAGE_MCOM03_SBL=y
BR2_PACKAGE_POWERVR_MDK=y
```
