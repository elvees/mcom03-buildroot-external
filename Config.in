## configs/mcom03fc_defconfig
```kconfig
BR2_aarch64=y
BR2_TOOLCHAIN_BUILDROOT_CXX=y
BR2_GCC_ENABLE_OPENMP=y
BR2_OPTIMIZE_3=y
BR2_INIT_SYSTEMD=y
BR2_SYSTEM_BIN_SH_BASH=y
# BR2_TARGET_GENERIC_GETTY is not set
BR2_ROOTFS_OVERLAY="${BR2_EXTERNAL_MCOM03_PATH}/overlay/elvees/common ${BR2_EXTERNAL_MCOM03_PATH}/overlay/elvees/mcom03fc"
BR2_ROOTFS_POST_BUILD_SCRIPT="${TARGET_DIR}/usr/bin/extlinux-gen"
BR2_ROOTFS_POST_FAKEROOT_SCRIPT="${BR2_EXTERNAL_MCOM03_PATH}/board/elvees/post-fakeroot.sh"
BR2_ROOTFS_POST_SCRIPT_ARGS="-a /usr/corpneo/projects/mcom03/assets/:/usr/corpneo/projects/mcom03/facesdk_test_videos/pedestrian_area.h264:/usr/corpneo/projects/mcom03-isp/:/usr/corpneo/projects/mcom03-vpu/dec*:/usr/corpneo/projects/mcom03-vpu/enc* -m fstrim.service,fstrim.timer,systemd-fsck-root.service,systemd-journald-flush.service,systemd-network-generator.service,systemd-pstore.service,systemd-timesyncd.service,systemd-tmpfiles-clean.service,systemd-tmpfiles-clean.timer"
BR2_LINUX_KERNEL=y
BR2_LINUX_KERNEL_CUSTOM_GIT=y
BR2_LINUX_KERNEL_CUSTOM_REPO_URL="https://review.elvees.com/mcom03/linux"
BR2_LINUX_KERNEL_CUSTOM_REPO_VERSION="mcom03-6.6.y"
BR2_LINUX_KERNEL_DEFCONFIG="mcom03fc"
BR2_LINUX_KERNEL_DTS_SUPPORT=y
BR2_LINUX_KERNEL_INTREE_DTS_NAME="elvees/*"
BR2_LINUX_KERNEL_DTB_KEEP_DIRNAME=y
BR2_LINUX_KERNEL_INSTALL_TARGET=y
BR2_LINUX_KERNEL_NEEDS_HOST_OPENSSL=y
BR2_PACKAGE_BUSYBOX_CONFIG="${BR2_EXTERNAL_MCOM03_PATH}/board/elvees/busybox.config"
BR2_PACKAGE_FIO=y
BR2_PACKAGE_STRESS_NG=y
BR2_PACKAGE_MTD=y
# BR2_PACKAGE_MTD_FLASHCP is not set
# BR2_PACKAGE_MTD_FLASH_ERASE is not set
# BR2_PACKAGE_MTD_FLASH_LOCK is not set
# BR2_PACKAGE_MTD_FLASH_UNLOCK is not set
# BR2_PACKAGE_MTD_MTD_DEBUG is not set
# BR2_PACKAGE_MTD_NANDDUMP is not set
# BR2_PACKAGE_MTD_NANDTEST is not set
# BR2_PACKAGE_MTD_NANDWRITE is not set
# BR2_PACKAGE_MTD_UBIATTACH is not set
# BR2_PACKAGE_MTD_UBICRC32 is not set
# BR2_PACKAGE_MTD_UBIDETACH is not set
# BR2_PACKAGE_MTD_UBIFORMAT is not set
# BR2_PACKAGE_MTD_UBIHEALTHD is not set
# BR2_PACKAGE_MTD_UBIMKVOL is not set
# BR2_PACKAGE_MTD_UBINFO is not set
# BR2_PACKAGE_MTD_UBINIZE is not set
# BR2_PACKAGE_MTD_UBIRENAME is not set
# BR2_PACKAGE_MTD_UBIRMVOL is not set
# BR2_PACKAGE_MTD_UBIRSVOL is not set
# BR2_PACKAGE_MTD_UBIUPDATEVOL is not set
# BR2_PACKAGE_MTD_UBIBLOCK is not set
BR2_PACKAGE_I2C_TOOLS=y
BR2_PACKAGE_PCIUTILS=y
BR2_PACKAGE_LIBDRM_INSTALL_TESTS=y
BR2_PACKAGE_LIBGPIOD_TOOLS=y
BR2_PACKAGE_COLLECTD=y
BR2_PACKAGE_COLLECTD_SENSORS=y
BR2_PACKAGE_CAN_UTILS=y
BR2_PACKAGE_IFMETRIC=y
# BR2_PACKAGE_IFUPDOWN_SCRIPTS is not set
BR2_PACKAGE_IPERF3=y
BR2_PACKAGE_IPROUTE2=y
BR2_PACKAGE_COREUTILS=y
BR2_PACKAGE_SYSTEMD_ANALYZE=y
# BR2_PACKAGE_SYSTEMD_NETWORKD is not set
# BR2_PACKAGE_SYSTEMD_RESOLVED is not set
BR2_PACKAGE_UTIL_LINUX_HWCLOCK=y
BR2_PACKAGE_UTIL_LINUX_UUIDD=y
BR2_TARGET_ROOTFS_TAR_GZIP=y
BR2_TARGET_ARM_TRUSTED_FIRMWARE=y
BR2_TARGET_ARM_TRUSTED_FIRMWARE_CUSTOM_GIT=y
BR2_TARGET_ARM_TRUSTED_FIRMWARE_CUSTOM_REPO_URL="ssh://gerrit.elvees.com:29418/mcom03/arm-trusted-firmware"
BR2_TARGET_ARM_TRUSTED_FIRMWARE_CUSTOM_REPO_VERSION="master"
BR2_TARGET_ARM_TRUSTED_FIRMWARE_PLATFORM="mcom03"
BR2_TARGET_ARM_TRUSTED_FIRMWARE_SSP=y
BR2_TARGET_UBOOT=y
BR2_TARGET_UBOOT_BUILD_SYSTEM_KCONFIG=y
BR2_TARGET_UBOOT_CUSTOM_GIT=y
BR2_TARGET_UBOOT_CUSTOM_REPO_URL="ssh://gerrit.elvees.com:29418/mcom03/u-boot"
BR2_TARGET_UBOOT_CUSTOM_REPO_VERSION="mcom03"
BR2_TARGET_UBOOT_BOARD_DEFCONFIG="mcom03"
BR2_TARGET_UBOOT_INSTALL_DTB=y
BR2_TARGET_UBOOT_INSTALL_DTB_SUBDIR="uboot-dtb"
BR2_PACKAGE_DDRINIT=y
BR2_PACKAGE_DDRINIT_DEFCONFIGS="elvmc03smarc-r1.0 elvmc03smarc-r1.0:bootrom elvmc03smarc-r2.2.0 elvmc03smarc-r2.2.0:bootrom elvmc03smarc-r2.6.1 elvmc03smarc-r2.6.1:bootrom elvmc03smarc-r2.7.1 elvmc03smarc-r2.7.1:bootrom elvmc03smarc-r2.9.1 elvmc03smarc-r2.9.1:bootrom elvmc03smarc-r2.10.0 elvmc03smarc-r2.10.0:bootrom elvmc03smarc-r2.11.0 elvmc03smarc-r2.11.0:bootrom egwpm egwpm:bootrom elvmc03-r2.2 elvmc03-r2.2:bootrom elvmc03q7-r1.0 elvmc03q7-r1.0:bootrom elvmc03q7-r2.1.1 elvmc03q7-r2.1.1:bootrom elvmc03q7-r2.8.1 elvmc03q7-r2.8.1:bootrom elvmc03q7-r2.11.1 elvmc03q7-r2.11.1:bootrom elvmc03ce-r2.4 elvmc03ce-r2.4:bootrom elvmc03ce-r2.5.0 elvmc03ce-r2.5.0:bootrom elvmc03ce-r2.8.1 elvmc03ce-r2.8.1:bootrom elvmc03ce-r2.11.0 elvmc03ce-r2.11.0:bootrom mcom03-ip-ku-m1-r1.0 mcom03-ip-ku-m1-r1.0:bootrom mcom03bub mcom03bub:bootrom monoboard-r1.1.1 monoboard-r1.1.1:bootrom monoboard-r1.2.2 monoboard-r1.2.2:bootrom pico-itx-r2 pico-itx-r2:bootrom skifmp-v1.0 skifmp-v1.0:bootrom trustphonepm trustphonepm:bootrom"
BR2_PACKAGE_DDRINIT_TOOLCHAIN="$(HOST_TOOLCHAIN_MIPSEL_ELVEES_ELF32_INSTALL_DIR)/bin/mipsel-elvees-elf-"
BR2_PACKAGE_MEMTESTER_SIMPLE=y
BR2_PACKAGE_PYTHON_PYFDT=y
BR2_PACKAGE_TAR2DEV=y
BR2_PACKAGE_UART_LOOPBACK_TEST=y
BR2_PACKAGE_DSP_COREMARK=y
BR2_PACKAGE_DSP_MEMTESTER=y
BR2_PACKAGE_ELCORECL_EXAMPLES=y
BR2_PACKAGE_HOST_BOOTROM_TOOLS=y
BR2_PACKAGE_MCOM03_SBL=y
BR2_PACKAGE_MCOM03_TL_SBIMG=y
BR2_PACKAGE_MCOM03_TL_SBIMG_CERTS_TAR="$(BR2_EXTERNAL_MCOM03_PATH)/board/elvees/certs.tar.gz"
BR2_PACKAGE_MCOM03_TL_SBIMG_SEC_TYPE_SIGN=y
BR2_PACKAGE_MCOM03_FELIX=y
BR2_PACKAGE_MCOM03_FELIX_LINUX_VERSION="6.6"
BR2_PACKAGE_MCOM03_FELIX_INSTALL_SRC=y
BR2_PACKAGE_MCOM03_LINUX_UTILS_PYTHON=y
# BR2_PACKAGE_MCOM03_LINUX_UTILS_PYTHON_INSTALL_LAW_RECORDER_DEPS is not set
BR2_PACKAGE_MCOM03_VPU_LIBS=y
BR2_PACKAGE_MCOM03_VPU_LIBS_INSTALL_SRC=y
BR2_PACKAGE_MCOM03_ROGUE_LIBS=y
BR2_PACKAGE_MCOM03_ROGUE_LIBS_INSTALL_SRC=y
```

## configs/mcom03haps_defconfig
```kconfig
BR2_aarch64=y
BR2_TOOLCHAIN_BUILDROOT_GLIBC=y
BR2_KERNEL_HEADERS_CUSTOM_GIT=y
BR2_KERNEL_HEADERS_CUSTOM_REPO_URL="ssh://gerrit.elvees.com:29418/linux/kernel"
BR2_KERNEL_HEADERS_CUSTOM_REPO_VERSION="mcom03"
BR2_PACKAGE_HOST_LINUX_HEADERS_CUSTOM_4_19=y
BR2_GCC_VERSION_8_X=y
BR2_TOOLCHAIN_BUILDROOT_CXX=y
BR2_ROOTFS_DEVICE_CREATION_DYNAMIC_EUDEV=y
BR2_SYSTEM_BIN_SH_BASH=y
BR2_TARGET_GENERIC_GETTY_PORT="ttyS0"
BR2_LINUX_KERNEL=y
BR2_LINUX_KERNEL_CUSTOM_GIT=y
BR2_LINUX_KERNEL_CUSTOM_REPO_URL="ssh://gerrit.elvees.com:29418/linux/kernel"
BR2_LINUX_KERNEL_CUSTOM_REPO_VERSION="mcom03"
BR2_LINUX_KERNEL_DEFCONFIG="mcom03haps"
BR2_LINUX_KERNEL_NEEDS_HOST_OPENSSL=y
BR2_PACKAGE_BUSYBOX_CONFIG="${BR2_EXTERNAL_MCOM03_PATH}/board/elvees/busybox.config"
BR2_PACKAGE_BUSYBOX_SHOW_OTHERS=y
BR2_PACKAGE_RAMSPEED=y
BR2_PACKAGE_TINYMEMBENCH=y
BR2_TARGET_ROOTFS_EXT2=y
BR2_TARGET_ROOTFS_EXT2_4=y
BR2_TARGET_ROOTFS_INITRAMFS=y
# BR2_TARGET_ROOTFS_TAR is not set
BR2_TARGET_UBOOT=y
BR2_TARGET_UBOOT_BUILD_SYSTEM_KCONFIG=y
BR2_TARGET_UBOOT_CUSTOM_GIT=y
BR2_TARGET_UBOOT_CUSTOM_REPO_URL="ssh://gerrit.elvees.com:29418/bootloader/u-boot"
BR2_TARGET_UBOOT_CUSTOM_REPO_VERSION="mcom03"
BR2_TARGET_UBOOT_BOARD_DEFCONFIG="mcom03haps"
BR2_PACKAGE_HOST_DOSFSTOOLS=y
BR2_PACKAGE_HOST_GENIMAGE=y
BR2_PACKAGE_HOST_MTOOLS=y
BR2_PACKAGE_COREMARK=y
BR2_PACKAGE_COREMARK_THREADS=4
BR2_PACKAGE_LINUX_STARTER=y
BR2_PACKAGE_MALI_VPU_LIBS=y
BR2_PACKAGE_MALI_VPU_KERN=y
```

## configs/mcom03oss_defconfig
```kconfig
BR2_aarch64=y
BR2_TOOLCHAIN_BUILDROOT_GLIBC=y
BR2_PACKAGE_HOST_LINUX_HEADERS_CUSTOM_4_19=y
BR2_GCC_VERSION_8_X=y
BR2_TOOLCHAIN_BUILDROOT_CXX=y
BR2_ROOTFS_DEVICE_CREATION_DYNAMIC_EUDEV=y
BR2_SYSTEM_BIN_SH_BASH=y
BR2_TARGET_GENERIC_GETTY_PORT="ttyS0"
BR2_LINUX_KERNEL=y
BR2_LINUX_KERNEL_CUSTOM_GIT=y
BR2_LINUX_KERNEL_CUSTOM_REPO_URL="ssh://gerrit.elvees.com:29418/linux/kernel"
BR2_LINUX_KERNEL_CUSTOM_REPO_VERSION="mcom03"
BR2_LINUX_KERNEL_DEFCONFIG="mcom03"
BR2_LINUX_KERNEL_NEEDS_HOST_OPENSSL=y
BR2_PACKAGE_LINUX_TOOLS_PERF=y
BR2_PACKAGE_LINUX_TOOLS_PERF_TUI=y
BR2_PACKAGE_LINUX_TOOLS_SELFTESTS=y
BR2_PACKAGE_BUSYBOX_CONFIG="${BR2_EXTERNAL_MCOM03_PATH}/board/elvees/busybox.config"
BR2_PACKAGE_BUSYBOX_SHOW_OTHERS=y
BR2_PACKAGE_FFMPEG=y
BR2_PACKAGE_FIO=y
BR2_PACKAGE_RAMSPEED=y
BR2_PACKAGE_TINYMEMBENCH=y
BR2_PACKAGE_HDPARM=y
BR2_PACKAGE_X264=y
BR2_PACKAGE_X264_CLI=y
BR2_PACKAGE_DHCPCD=y
BR2_PACKAGE_IPERF3=y
BR2_PACKAGE_LRZSZ=y
BR2_PACKAGE_NMAP=y
BR2_PACKAGE_NMAP_NCAT=y
BR2_PACKAGE_COREUTILS=y
BR2_TARGET_ROOTFS_EXT2=y
BR2_TARGET_ROOTFS_EXT2_4=y
BR2_TARGET_ROOTFS_EXT2_SIZE="250M"
BR2_TARGET_ROOTFS_INITRAMFS=y
# BR2_TARGET_ROOTFS_TAR is not set
BR2_TARGET_ARM_TRUSTED_FIRMWARE=y
BR2_TARGET_ARM_TRUSTED_FIRMWARE_CUSTOM_GIT=y
BR2_TARGET_ARM_TRUSTED_FIRMWARE_CUSTOM_REPO_URL="ssh://gerrit.elvees.com:29418/mcom03/arm-trusted-firmware"
BR2_TARGET_ARM_TRUSTED_FIRMWARE_CUSTOM_REPO_VERSION="master"
BR2_TARGET_ARM_TRUSTED_FIRMWARE_PLATFORM="mcom03"
BR2_TARGET_ARM_TRUSTED_FIRMWARE_ADDITIONAL_VARIABLES="PLAT_MCOM03_HAPS=1"
BR2_TARGET_UBOOT=y
BR2_TARGET_UBOOT_BUILD_SYSTEM_KCONFIG=y
BR2_TARGET_UBOOT_CUSTOM_GIT=y
BR2_TARGET_UBOOT_CUSTOM_REPO_URL="ssh://gerrit.elvees.com:29418/bootloader/u-boot"
BR2_TARGET_UBOOT_CUSTOM_REPO_VERSION="mcom03"
BR2_TARGET_UBOOT_BOARD_DEFCONFIG="mcom03haps"
BR2_PACKAGE_HOST_DOSFSTOOLS=y
BR2_PACKAGE_HOST_GENIMAGE=y
BR2_PACKAGE_HOST_MTOOLS=y
BR2_PACKAGE_ELVEES_COREMARK=y
BR2_PACKAGE_ELVEES_COREMARK_THREADS=4
BR2_PACKAGE_DOOL=y
BR2_PACKAGE_ACPTEST=y
```

## configs/mcom03r-fc_defconfig
```kconfig
BR2_aarch64=y
BR2_TOOLCHAIN_BUILDROOT_CXX=y
BR2_GCC_ENABLE_OPENMP=y
BR2_OPTIMIZE_3=y
BR2_INIT_SYSTEMD=y
BR2_SYSTEM_BIN_SH_BASH=y
# BR2_TARGET_GENERIC_GETTY is not set
BR2_ROOTFS_OVERLAY="${BR2_EXTERNAL_MCOM03_PATH}/overlay/elvees/common ${BR2_EXTERNAL_MCOM03_PATH}/overlay/elvees/mcom03fc"
BR2_ROOTFS_POST_BUILD_SCRIPT="${TARGET_DIR}/usr/bin/extlinux-gen"
BR2_ROOTFS_POST_FAKEROOT_SCRIPT="${BR2_EXTERNAL_MCOM03_PATH}/board/elvees/post-fakeroot.sh"
BR2_ROOTFS_POST_SCRIPT_ARGS="-a /usr/corpneo/projects/mcom03/assets/:/usr/corpneo/projects/mcom03/facesdk_test_videos/pedestrian_area.h264:/usr/corpneo/projects/mcom03-isp/:/usr/corpneo/projects/mcom03-vpu/dec*:/usr/corpneo/projects/mcom03-vpu/enc* -m fstrim.service,fstrim.timer,systemd-fsck-root.service,systemd-journald-flush.service,systemd-network-generator.service,systemd-pstore.service,systemd-timesyncd.service,systemd-tmpfiles-clean.service,systemd-tmpfiles-clean.timer"
BR2_LINUX_KERNEL=y
BR2_LINUX_KERNEL_CUSTOM_GIT=y
BR2_LINUX_KERNEL_CUSTOM_REPO_URL="https://review.elvees.com/mcom03/linux"
BR2_LINUX_KERNEL_CUSTOM_REPO_VERSION="mcom03-6.6.y"
BR2_LINUX_KERNEL_DEFCONFIG="mcom03r-fc"
BR2_LINUX_KERNEL_DTS_SUPPORT=y
BR2_LINUX_KERNEL_INTREE_DTS_NAME="elvees/mcom03r-*"
BR2_LINUX_KERNEL_DTB_KEEP_DIRNAME=y
BR2_LINUX_KERNEL_INSTALL_TARGET=y
BR2_LINUX_KERNEL_NEEDS_HOST_OPENSSL=y
BR2_PACKAGE_BUSYBOX_CONFIG="${BR2_EXTERNAL_MCOM03_PATH}/board/elvees/busybox.config"
BR2_PACKAGE_GSTREAMER1=y
BR2_PACKAGE_GST1_PLUGINS_BASE_PLUGIN_VIDEOTESTSRC=y
BR2_PACKAGE_GST1_PLUGINS_GOOD=y
BR2_PACKAGE_GST1_PLUGINS_GOOD_PNG=y
BR2_PACKAGE_GST1_PLUGINS_GOOD_PLUGIN_MULTIFILE=y
BR2_PACKAGE_GST1_PLUGINS_BAD=y
BR2_PACKAGE_GST1_PLUGINS_BAD_PLUGIN_KMS=y
BR2_PACKAGE_GST_OMX=y
BR2_PACKAGE_FIO=y
BR2_PACKAGE_SPIDEV_TEST=y
BR2_PACKAGE_STRESS_NG=y
BR2_PACKAGE_MTD=y
# BR2_PACKAGE_MTD_FLASHCP is not set
# BR2_PACKAGE_MTD_FLASH_ERASE is not set
# BR2_PACKAGE_MTD_FLASH_LOCK is not set
# BR2_PACKAGE_MTD_FLASH_UNLOCK is not set
# BR2_PACKAGE_MTD_MTD_DEBUG is not set
# BR2_PACKAGE_MTD_NANDDUMP is not set
# BR2_PACKAGE_MTD_NANDTEST is not set
# BR2_PACKAGE_MTD_NANDWRITE is not set
# BR2_PACKAGE_MTD_UBIATTACH is not set
# BR2_PACKAGE_MTD_UBICRC32 is not set
# BR2_PACKAGE_MTD_UBIDETACH is not set
# BR2_PACKAGE_MTD_UBIFORMAT is not set
# BR2_PACKAGE_MTD_UBIHEALTHD is not set
# BR2_PACKAGE_MTD_UBIMKVOL is not set
# BR2_PACKAGE_MTD_UBINFO is not set
# BR2_PACKAGE_MTD_UBINIZE is not set
# BR2_PACKAGE_MTD_UBIRENAME is not set
# BR2_PACKAGE_MTD_UBIRMVOL is not set
# BR2_PACKAGE_MTD_UBIRSVOL is not set
# BR2_PACKAGE_MTD_UBIUPDATEVOL is not set
# BR2_PACKAGE_MTD_UBIBLOCK is not set
BR2_PACKAGE_WESTON=y
BR2_PACKAGE_I2C_TOOLS=y
BR2_PACKAGE_PCIUTILS=y
BR2_PACKAGE_LIBDRM_INSTALL_TESTS=y
BR2_PACKAGE_LIBGPIOD_TOOLS=y
BR2_PACKAGE_LINUX_PAM=y
BR2_PACKAGE_COLLECTD=y
BR2_PACKAGE_COLLECTD_SENSORS=y
BR2_PACKAGE_CAN_UTILS=y
BR2_PACKAGE_ETHTOOL=y
# BR2_PACKAGE_ETHTOOL_PRETTY_PRINT is not set
BR2_PACKAGE_IFMETRIC=y
# BR2_PACKAGE_IFUPDOWN_SCRIPTS is not set
BR2_PACKAGE_IPERF3=y
BR2_PACKAGE_IPROUTE2=y
BR2_PACKAGE_COREUTILS=y
BR2_PACKAGE_SYSTEMD_ANALYZE=y
# BR2_PACKAGE_SYSTEMD_NETWORKD is not set
# BR2_PACKAGE_SYSTEMD_RESOLVED is not set
BR2_PACKAGE_UTIL_LINUX_HWCLOCK=y
BR2_PACKAGE_UTIL_LINUX_SCHEDUTILS=y
BR2_PACKAGE_UTIL_LINUX_UUIDD=y
BR2_TARGET_ROOTFS_TAR_GZIP=y
BR2_TARGET_ARM_TRUSTED_FIRMWARE=y
BR2_TARGET_ARM_TRUSTED_FIRMWARE_CUSTOM_GIT=y
BR2_TARGET_ARM_TRUSTED_FIRMWARE_CUSTOM_REPO_URL="ssh://gerrit.elvees.com:29418/mcom03/arm-trusted-firmware"
BR2_TARGET_ARM_TRUSTED_FIRMWARE_CUSTOM_REPO_VERSION="master"
BR2_TARGET_ARM_TRUSTED_FIRMWARE_PLATFORM="mcom03"
BR2_TARGET_ARM_TRUSTED_FIRMWARE_SSP=y
BR2_TARGET_UBOOT=y
BR2_TARGET_UBOOT_BUILD_SYSTEM_KCONFIG=y
BR2_TARGET_UBOOT_CUSTOM_GIT=y
BR2_TARGET_UBOOT_CUSTOM_REPO_URL="ssh://gerrit.elvees.com:29418/mcom03/u-boot"
BR2_TARGET_UBOOT_CUSTOM_REPO_VERSION="mcom03"
BR2_TARGET_UBOOT_BOARD_DEFCONFIG="mcom03r"
BR2_TARGET_UBOOT_INSTALL_DTB=y
BR2_TARGET_UBOOT_INSTALL_DTB_SUBDIR="uboot-dtb"
BR2_PACKAGE_HOST_UBOOT_TOOLS=y
BR2_PACKAGE_HOST_UBOOT_TOOLS_ENVIMAGE=y
BR2_PACKAGE_HOST_UBOOT_TOOLS_ENVIMAGE_SIZE="65536"
BR2_PACKAGE_DDRINIT=y
BR2_PACKAGE_DDRINIT_DEFCONFIGS="elvmc03smarc-r3.0.0 elvmc03smarc-r3.0.0:bootrom ip-ku-m1-r1.0 ip-ku-m1-r1.0:bootrom ip-ku-m1-r1.0:pll-cfg-override:ddr4-rate-1250 skifmsb-v2.0 skifmsb-v2.0:bootrom"
BR2_PACKAGE_DDRINIT_TOOLCHAIN="$(HOST_TOOLCHAIN_MIPSEL_ELVEES_ELF32_INSTALL_DIR)/bin/mipsel-elvees-elf-"
BR2_PACKAGE_ELVEES_GLBENCH=y
BR2_PACKAGE_MEMTESTER_SIMPLE=y
BR2_PACKAGE_PYTHON_PARALLEL_TEST=y
BR2_PACKAGE_PYTHON_PYFDT=y
BR2_PACKAGE_TAR2DEV=y
BR2_PACKAGE_UART_LOOPBACK_TEST=y
BR2_PACKAGE_DSP_COREMARK=y
BR2_PACKAGE_DSP_ELCORE50_LIBRARIES=y
BR2_PACKAGE_DSP_MEMTESTER=y
BR2_ELCORE50_DUMP=y
BR2_PACKAGE_ELCORECL_EXAMPLES=y
BR2_PACKAGE_ELCORECL_EXTRA=y
BR2_PACKAGE_HOST_BOOTROM_TOOLS=y
BR2_PACKAGE_MCOM03_BAREMETAL_TOOLS=y
BR2_PACKAGE_MCOM03_BAREMETAL_TOOLS_ARM64=y
BR2_PACKAGE_MCOM03_SBL=y
BR2_PACKAGE_MCOM03_SBL_SBIMG_SEC_TYPE_NONE=y
BR2_MCOM03_DDRINIT_DTB_MAP="$(BR2_EXTERNAL_MCOM03_PATH)/board/elvees/mcom03r-ddrinit-dtb-map.txt"
BR2_PACKAGE_GST_FELIX=y
BR2_PACKAGE_MCOM03_FELIX_LINUX_VERSION="6.6"
BR2_PACKAGE_MCOM03_FELIX_INSTALL_SRC=y
BR2_PACKAGE_MCOM03_LINUX_UTILS=y
BR2_PACKAGE_MCOM03_LINUX_UTILS_WESTON=y
BR2_PACKAGE_MCOM03_LINUX_UTILS_PYTHON=y
# BR2_PACKAGE_MCOM03_LINUX_UTILS_PYTHON_INSTALL_LAW_RECORDER_DEPS is not set
BR2_PACKAGE_MCOM03_VPU_LIBS=y
BR2_PACKAGE_MCOM03_VPU_LIBS_INSTALL_SRC=y
BR2_PACKAGE_MCOM03_ROGUE_LIBS=y
BR2_PACKAGE_MCOM03_ROGUE_LIBS_INSTALL_SRC=y
BR2_ELVEES_BINARY_PACKAGES_SITE="http://dist.elvees.com/mcom03r/packages"
```
