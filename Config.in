## package/mcom03-hwinit/Config.in
```kconfig
config BR2_PACKAGE_MCOM03_HWINIT
	bool "mcom03-hwinit"
	help
	  The package is a part of trusted second
	  bootloader. It is responsible to setup
	  hardware during boot stages.

if BR2_PACKAGE_MCOM03_HWINIT

config BR2_PACKAGE_MCOM03_HWINIT_TOOLCHAIN
	string "Toolchain"
	help
	  Path to the toolchain file to cross-compile
	  hwinit with.

config BR2_PACKAGE_MCOM03_HWINIT_ADDITIONAL_VARIABLES
	string "Additional hwinit build variables"
	help
	  Additional parameters for the hwinit build
	  E.G. 'WDT_ENABLE=y DEBUG=y'

endif
```

## package/mcom03-linux-utils-python/Config.in
```kconfig
config BR2_PACKAGE_MCOM03_LINUX_UTILS_PYTHON
	bool "mcom03-linux-utils-python"
	select BR2_PACKAGE_ALSA_UTILS
	select BR2_PACKAGE_ALSA_UTILS_APLAY
	select BR2_PACKAGE_FFMPEG
	select BR2_PACKAGE_FFMPEG_FFPROBE
	select BR2_PACKAGE_GSTREAMER1
	select BR2_PACKAGE_GST1_PLUGINS_BASE
	select BR2_PACKAGE_GST1_PLUGINS_BASE_PLUGIN_ALSA
	select BR2_PACKAGE_GST1_PLUGINS_BASE_PLUGIN_AUDIOCONVERT
	select BR2_PACKAGE_GST1_PLUGINS_BASE_PLUGIN_AUDIORESAMPLE
	select BR2_PACKAGE_GST1_PLUGINS_GOOD
	select BR2_PACKAGE_GST1_PLUGINS_GOOD_PLUGIN_LAW
	select BR2_PACKAGE_GST1_PLUGINS_GOOD_PLUGIN_WAVENC
	select BR2_PACKAGE_PYTHON3
	select BR2_PACKAGE_PYTHON_LUMA_OLED
	help
	  Miscellaneous python utilities for MCom-03
```

## package/mcom03-linux-utils/Config.in
```kconfig
config BR2_PACKAGE_MCOM03_LINUX_UTILS
	bool "mcom03-linux-utils"
	select BR2_PACKAGE_MPV
	help
	  Miscellaneous utilities for MCom-03

config BR2_PACKAGE_MCOM03_LINUX_UTILS_SET_HOSTNAME_SERVICE
	bool "Enable mcom03-set-hostname service"
	depends on BR2_PACKAGE_MCOM03_LINUX_UTILS

config BR2_PACKAGE_MCOM03_LINUX_UTILS_MONOBOARD
	bool "Enable Monoboard services"
	depends on BR2_PACKAGE_MCOM03_LINUX_UTILS

config BR2_PACKAGE_MCOM03_LINUX_UTILS_WESTON
	bool "Enable mcom03-weston service"
	depends on BR2_PACKAGE_MCOM03_LINUX_UTILS
	depends on BR2_PACKAGE_WESTON

comment "mcom03-weston needs weston"
	depends on !BR2_PACKAGE_WESTON
	depends on BR2_PACKAGE_MCOM03_LINUX_UTILS
```
