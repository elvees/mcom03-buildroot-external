## configs/mcom03r_smarcr3-fc_defconfig
```kconfig
BR2_aarch64=y
BR2_TOOLCHAIN_BUILDROOT_CXX=y
BR2_GCC_ENABLE_OPENMP=y
BR2_OPTIMIZE_3=y
BR2_INIT_SYSTEMD=y
BR2_SYSTEM_BIN_SH_BASH=y
# BR2_TARGET_GENERIC_GETTY is not set
BR2_ROOTFS_OVERLAY="${BR2_EXTERNAL_MCOM03_PATH}/overlay/elvees/common ${BR2_EXTERNAL_MCOM03_PATH}/overlay/elvees/mcom03fc"
BR2_ROOTFS_POST_BUILD_SCRIPT="${TARGET_DIR}/usr/bin/extlinux-gen"
BR2_ROOTFS_POST_FAKEROOT_SCRIPT="${BR2_EXTERNAL_MCOM03_PATH}/board/elvees/post-fakeroot.sh"
BR2_ROOTFS_POST_SCRIPT_ARGS="-a /usr/corpneo/projects/mcom03/assets/:/usr/corpneo/projects/mcom03/facesdk_test_videos/pedestrian_area.h264:/usr/corpneo/projects/mcom03-isp/:/usr/corpneo/projects/mcom03-vpu/dec*:/usr/corpneo/projects/mcom03-vpu/enc* -m fstrim.service,fstrim.timer,systemd-fsck-root.service,systemd-journald-flush.service,systemd-network-generator.service,systemd-pstore.service,systemd-timesyncd.service,systemd-tmpfiles-clean.service,systemd-tmpfiles-clean.timer"
BR2_LINUX_KERNEL=y
BR2_LINUX_KERNEL_CUSTOM_GIT=y
BR2_LINUX_KERNEL_CUSTOM_REPO_URL="https://review.elvees.com/mcom03/linux"
BR2_LINUX_KERNEL_CUSTOM_REPO_VERSION="mcom03-6.6.y"
BR2_LINUX_KERNEL_DEFCONFIG="mcom03r-smarc-fc"
BR2_LINUX_KERNEL_CONFIG_FRAGMENT_FILES="${BR2_EXTERNAL_MCOM03_PATH}/board/elvees/linux-nowdt.fragment"
BR2_LINUX_KERNEL_DTS_SUPPORT=y
BR2_LINUX_KERNEL_INTREE_DTS_NAME="elvees/mcom03r-elvmc03smarc-*"
BR2_LINUX_KERNEL_DTB_KEEP_DIRNAME=y
BR2_LINUX_KERNEL_INSTALL_TARGET=y
BR2_LINUX_KERNEL_NEEDS_HOST_OPENSSL=y
BR2_PACKAGE_LINUX_TOOLS_GPIO=y
BR2_PACKAGE_LINUX_TOOLS_SELFTESTS=y
BR2_PACKAGE_BUSYBOX_CONFIG="${BR2_EXTERNAL_MCOM03_PATH}/board/elvees/busybox.config"
BR2_PACKAGE_ALSA_UTILS_AMIXER=y
BR2_PACKAGE_FFMPEG_FFPLAY=y
BR2_PACKAGE_GST1_PLUGINS_BASE_PLUGIN_AUDIORATE=y
BR2_PACKAGE_GST1_PLUGINS_BASE_PLUGIN_VIDEOTESTSRC=y
BR2_PACKAGE_GST1_PLUGINS_GOOD_PLUGIN_MULTIFILE=y
BR2_PACKAGE_GST1_PLUGINS_BAD=y
BR2_PACKAGE_GST1_PLUGINS_BAD_PLUGIN_DEBUGUTILS=y
BR2_PACKAGE_GST1_PLUGINS_BAD_PLUGIN_VIDEOPARSERS=y
BR2_PACKAGE_GST1_PLUGINS_BAD_PLUGIN_KMS=y
BR2_PACKAGE_GST1_INTERPIPE=y
BR2_PACKAGE_GST_OMX=y
BR2_PACKAGE_FIO=y
BR2_PACKAGE_STRESS_NG=y
BR2_PACKAGE_MTD=y
BR2_PACKAGE_WESTON=y
BR2_PACKAGE_LINUX_FIRMWARE=y
BR2_PACKAGE_LINUX_FIRMWARE_LONTIUM=y
BR2_PACKAGE_EVTEST=y
BR2_PACKAGE_I2C_TOOLS=y
BR2_PACKAGE_PCIUTILS=y
BR2_PACKAGE_SMARTMONTOOLS=y
BR2_PACKAGE_LIBDRM_INSTALL_TESTS=y
BR2_PACKAGE_LIBGPIOD_TOOLS=y
BR2_PACKAGE_LINUX_PAM=y
BR2_PACKAGE_COLLECTD=y
BR2_PACKAGE_COLLECTD_SENSORS=y
BR2_PACKAGE_CAN_UTILS=y
BR2_PACKAGE_ETHTOOL=y
BR2_PACKAGE_IFMETRIC=y
BR2_PACKAGE_IPERF3=y
BR2_PACKAGE_IPROUTE2=y
BR2_PACKAGE_COREUTILS=y
BR2_PACKAGE_SYSTEMD_ANALYZE=y
# BR2_PACKAGE_SYSTEMD_NETWORKD is not set
# BR2_PACKAGE_SYSTEMD_RESOLVED is not set
BR2_PACKAGE_UTIL_LINUX_HWCLOCK=y
BR2_PACKAGE_UTIL_LINUX_UUIDD=y
BR2_TARGET_ROOTFS_TAR_GZIP=y
BR2_TARGET_ARM_TRUSTED_FIRMWARE=y
BR2_TARGET_ARM_TRUSTED_FIRMWARE_CUSTOM_GIT=y
BR2_TARGET_ARM_TRUSTED_FIRMWARE_CUSTOM_REPO_URL="ssh://gerrit.elvees.com:29418/mcom03/arm-trusted-firmware"
BR2_TARGET_ARM_TRUSTED_FIRMWARE_CUSTOM_REPO_VERSION="master"
BR2_TARGET_ARM_TRUSTED_FIRMWARE_PLATFORM="mcom03"
BR2_TARGET_ARM_TRUSTED_FIRMWARE_SSP=y
BR2_TARGET_UBOOT=y
BR2_TARGET_UBOOT_BUILD_SYSTEM_KCONFIG=y
BR2_TARGET_UBOOT_CUSTOM_GIT=y
BR2_TARGET_UBOOT_CUSTOM_REPO_URL="ssh://gerrit.elvees.com:29418/mcom03/u-boot"
BR2_TARGET_UBOOT_CUSTOM_REPO_VERSION="mcom03"
BR2_TARGET_UBOOT_BOARD_DEFCONFIG="mcom03r"
BR2_TARGET_UBOOT_CONFIG_FRAGMENT_FILES="${BR2_EXTERNAL_MCOM03_PATH}/board/elvees/uboot-nowdt.fragment"
BR2_TARGET_UBOOT_INSTALL_DTB=y
BR2_TARGET_UBOOT_INSTALL_DTB_SUBDIR="uboot-dtb"
BR2_PACKAGE_HOST_UBOOT_TOOLS=y
BR2_PACKAGE_HOST_UBOOT_TOOLS_ENVIMAGE=y
BR2_PACKAGE_HOST_UBOOT_TOOLS_ENVIMAGE_SIZE="65536"
BR2_PACKAGE_DDRINIT=y
BR2_PACKAGE_DDRINIT_DEFCONFIGS="elvmc03smarc-r3.0.0 elvmc03smarc-r3.0.0:bootrom"
BR2_PACKAGE_DDRINIT_TOOLCHAIN="$(HOST_TOOLCHAIN_MIPSEL_ELVEES_ELF32_INSTALL_DIR)/bin/mipsel-elvees-elf-"
BR2_PACKAGE_ELVEES_GLBENCH=y
BR2_PACKAGE_MEMTESTER_SIMPLE=y
BR2_PACKAGE_PYTHON_PARALLEL_TEST=y
BR2_PACKAGE_PYTHON_PYFDT=y
BR2_PACKAGE_TAR2DEV=y
BR2_PACKAGE_UART_LOOPBACK_TEST=y
BR2_PACKAGE_DSP_COREMARK=y
BR2_PACKAGE_DSP_ELCORE50_LIBRARIES=y
BR2_PACKAGE_DSP_MEMTESTER=y
BR2_PACKAGE_ELCORECL_EXAMPLES=y
BR2_PACKAGE_ELCORECL_EXTRA=y
BR2_PACKAGE_HOST_BOOTROM_TOOLS=y
BR2_PACKAGE_MCOM03_SBL=y
BR2_PACKAGE_MCOM03_SBL_SBIMG_SEC_TYPE_SIGN=y
BR2_PACKAGE_MCOM03_SBL_SBIMG_CERTS_TAR="$(BR2_EXTERNAL_MCOM03_PATH)/board/elvees/certs.tar.gz"
BR2_PACKAGE_MCOM03_SBL_ADDITIONAL_VARIABLES="-DWDT_ENABLE=FALSE"
BR2_MCOM03_DDRINIT_DTB_MAP="$(BR2_EXTERNAL_MCOM03_PATH)/board/elvees/mcom03r-smarcr3-fc-dtb-map.txt"
BR2_PACKAGE_GST_FELIX=y
BR2_PACKAGE_MCOM03_FELIX_LINUX_VERSION="6.6"
BR2_PACKAGE_MCOM03_LINUX_UTILS=y
BR2_PACKAGE_MCOM03_LINUX_UTILS_WESTON=y
BR2_PACKAGE_MCOM03_LINUX_UTILS_PYTHON=y
BR2_PACKAGE_MCOM03_VPU_LIBS=y
BR2_PACKAGE_MCOM03_ROGUE_LIBS=y
BR2_ELVEES_BINARY_PACKAGES_SITE="http://dist.elvees.com/mcom03r/packages"
```

## configs/mcom03rtl_defconfig
```kconfig
BR2_aarch64=y
BR2_TOOLCHAIN_BUILDROOT_GLIBC=y
BR2_KERNEL_HEADERS_CUSTOM_GIT=y
BR2_KERNEL_HEADERS_CUSTOM_REPO_URL="ssh://gerrit.elvees.com:29418/linux/kernel"
BR2_KERNEL_HEADERS_CUSTOM_REPO_VERSION="mcom03"
BR2_PACKAGE_HOST_LINUX_HEADERS_CUSTOM_4_19=y
BR2_GCC_VERSION_8_X=y
BR2_TOOLCHAIN_BUILDROOT_CXX=y
BR2_ROOTFS_DEVICE_CREATION_DYNAMIC_EUDEV=y
BR2_TARGET_GENERIC_GETTY_PORT="ttyS0"
BR2_LINUX_KERNEL=y
BR2_LINUX_KERNEL_CUSTOM_GIT=y
BR2_LINUX_KERNEL_CUSTOM_REPO_URL="ssh://gerrit.elvees.com:29418/linux/kernel"
BR2_LINUX_KERNEL_CUSTOM_REPO_VERSION="mcom03"
BR2_LINUX_KERNEL_DEFCONFIG="mcom03rtl"
BR2_LINUX_KERNEL_NEEDS_HOST_OPENSSL=y
BR2_PACKAGE_BUSYBOX_CONFIG="${BR2_EXTERNAL_MCOM03_PATH}/board/elvees/busybox.config"
BR2_TARGET_ROOTFS_EXT2=y
BR2_TARGET_ROOTFS_EXT2_4=y
# BR2_TARGET_ROOTFS_TAR is not set
BR2_TARGET_UBOOT=y
BR2_TARGET_UBOOT_BUILD_SYSTEM_KCONFIG=y
BR2_TARGET_UBOOT_CUSTOM_GIT=y
BR2_TARGET_UBOOT_CUSTOM_REPO_URL="ssh://gerrit.elvees.com:29418/bootloader/u-boot"
BR2_TARGET_UBOOT_CUSTOM_REPO_VERSION="mcom03"
BR2_TARGET_UBOOT_BOARD_DEFCONFIG="mcom03rtl"
BR2_PACKAGE_HOST_DOSFSTOOLS=y
BR2_PACKAGE_HOST_GENIMAGE=y
BR2_PACKAGE_HOST_MTOOLS=y
BR2_PACKAGE_RTL_TEST_STOP=y
```

## configs/ngfwcb_defconfig
```kconfig
BR2_aarch64=y
BR2_OPTIMIZE_3=y
BR2_TOOLCHAIN_BUILDROOT_GLIBC=y
BR2_PACKAGE_HOST_LINUX_HEADERS_CUSTOM_4_19=y
BR2_GCC_VERSION_8_X=y
BR2_TOOLCHAIN_BUILDROOT_CXX=y
BR2_GCC_ENABLE_OPENMP=y
BR2_ROOTFS_DEVICE_CREATION_DYNAMIC_EUDEV=y
BR2_SYSTEM_BIN_SH_BASH=y
BR2_TARGET_GENERIC_GETTY_PORT="ttyS0"
BR2_ROOTFS_OVERLAY="${BR2_EXTERNAL_MCOM03_PATH}/overlay/elvees"
BR2_ROOTFS_POST_IMAGE_SCRIPT="support/scripts/genimage.sh"
BR2_ROOTFS_POST_SCRIPT_ARGS="-c ${BR2_EXTERNAL_MCOM03_PATH}/board/elvees/sd-image.cfg"
BR2_LINUX_KERNEL=y
BR2_LINUX_KERNEL_CUSTOM_GIT=y
BR2_LINUX_KERNEL_CUSTOM_REPO_URL="ssh://gerrit.elvees.com:29418/linux/kernel"
BR2_LINUX_KERNEL_CUSTOM_REPO_VERSION="mcom03"
BR2_LINUX_KERNEL_DEFCONFIG="mcom03"
BR2_LINUX_KERNEL_DTS_SUPPORT=y
BR2_LINUX_KERNEL_INTREE_DTS_NAME="elvees/mcom03-bub-r1.3.0 elvees/mcom03-elvmc03smarc-r1.0-ngfwcb-r1.0"
BR2_LINUX_KERNEL_DTB_KEEP_DIRNAME=y
BR2_LINUX_KERNEL_NEEDS_HOST_OPENSSL=y
BR2_PACKAGE_LINUX_TOOLS_GPIO=y
BR2_PACKAGE_LINUX_TOOLS_PERF=y
BR2_PACKAGE_LINUX_TOOLS_PERF_TUI=y
BR2_PACKAGE_LINUX_TOOLS_SELFTESTS=y
BR2_PACKAGE_BUSYBOX_CONFIG="${BR2_EXTERNAL_MCOM03_PATH}/board/elvees/busybox.config"
BR2_PACKAGE_BUSYBOX_SHOW_OTHERS=y
BR2_PACKAGE_FFMPEG_FFPLAY=y
BR2_PACKAGE_FIO=y
BR2_PACKAGE_RAMSPEED=y
BR2_PACKAGE_STRESS_NG=y
BR2_PACKAGE_TINYMEMBENCH=y
BR2_PACKAGE_DOSFSTOOLS=y
BR2_PACKAGE_DOSFSTOOLS_FATLABEL=y
BR2_PACKAGE_DOSFSTOOLS_FSCK_FAT=y
BR2_PACKAGE_DOSFSTOOLS_MKFS_FAT=y
BR2_PACKAGE_E2FSPROGS=y
BR2_PACKAGE_E2FSPROGS_DEBUGFS=y
BR2_PACKAGE_E2FSPROGS_E2IMAGE=y
BR2_PACKAGE_E2FSPROGS_E4DEFRAG=y
BR2_PACKAGE_E2FSPROGS_FUSE2FS=y
BR2_PACKAGE_E2FSPROGS_RESIZE2FS=y
BR2_PACKAGE_MTD=y
BR2_PACKAGE_MTD_MKFSUBIFS=y
BR2_PACKAGE_MTD_SUMTOOL=y
BR2_PACKAGE_MTD_TESTS=y
BR2_PACKAGE_HDPARM=y
BR2_PACKAGE_I2C_TOOLS=y
BR2_PACKAGE_LM_SENSORS=y
BR2_PACKAGE_MEMTESTER=y
BR2_PACKAGE_PYTHON3=y
BR2_PACKAGE_LIBDRM=y
BR2_PACKAGE_LIBDRM_INSTALL_TESTS=y
BR2_PACKAGE_LIBGPIOD=y
BR2_PACKAGE_LIBGPIOD_TOOLS=y
BR2_PACKAGE_TINYXML2=y
BR2_PACKAGE_DHCPCD=y
BR2_PACKAGE_IPERF3=y
BR2_PACKAGE_LRZSZ=y
BR2_PACKAGE_NMAP=y
BR2_PACKAGE_NMAP_NCAT=y
BR2_PACKAGE_OPENSSH=y
BR2_PACKAGE_COREUTILS=y
BR2_PACKAGE_UTIL_LINUX_UUIDD=y
BR2_PACKAGE_NANO=y
BR2_TARGET_ROOTFS_EXT2=y
BR2_TARGET_ROOTFS_EXT2_4=y
BR2_TARGET_ROOTFS_EXT2_SIZE="1000M"
BR2_TARGET_ARM_TRUSTED_FIRMWARE=y
BR2_TARGET_ARM_TRUSTED_FIRMWARE_CUSTOM_GIT=y
BR2_TARGET_ARM_TRUSTED_FIRMWARE_CUSTOM_REPO_URL="ssh://gerrit.elvees.com:29418/mcom03/arm-trusted-firmware"
BR2_TARGET_ARM_TRUSTED_FIRMWARE_CUSTOM_REPO_VERSION="master"
BR2_TARGET_ARM_TRUSTED_FIRMWARE_PLATFORM="mcom03"
BR2_TARGET_UBOOT=y
BR2_TARGET_UBOOT_BUILD_SYSTEM_KCONFIG=y
BR2_TARGET_UBOOT_CUSTOM_GIT=y
BR2_TARGET_UBOOT_CUSTOM_REPO_URL="ssh://gerrit.elvees.com:29418/bootloader/u-boot"
BR2_TARGET_UBOOT_CUSTOM_REPO_VERSION="mcom03"
BR2_TARGET_UBOOT_BOARD_DEFCONFIG="ngfwcb"
BR2_TARGET_UBOOT_ENVIMAGE=y
BR2_TARGET_UBOOT_ENVIMAGE_SIZE="65536"
BR2_PACKAGE_HOST_CMAKE=y
BR2_PACKAGE_HOST_DOSFSTOOLS=y
BR2_PACKAGE_HOST_GENIMAGE=y
BR2_PACKAGE_HOST_MTOOLS=y
BR2_PACKAGE_DDRINIT=y
BR2_PACKAGE_DDRINIT_DEFCONFIGS="elvmc03smarc"
BR2_PACKAGE_DDRINIT_TOOLCHAIN="$(TARGET_CROSS)"
BR2_PACKAGE_MEMTESTER_SIMPLE=y
BR2_PACKAGE_PYTHON_PARALLEL_TEST=y
BR2_PACKAGE_PYTHON_PYFDT=y
BR2_PACKAGE_ELCORECL_EXTRA=y
BR2_PACKAGE_MCOM03_LINUX_UTILS=y
BR2_PACKAGE_MCOM03_LINUX_UTILS_PYTHON=y
BR2_PACKAGE_MCOM03_SBL=y
```

## package/acptest/Config.in
```kconfig
config BR2_PACKAGE_ACPTEST
	bool "acptest"
	help
	  A kernel module for testing ACP-port on MCom-03.
```

## package/bootrom-tools/Config.in
```kconfig
config BR2_PACKAGE_HOST_BOOTROM_TOOLS
	bool "bootrom-tools"
	help
	  The tool to create and analyze binary images
	  in SBIMG format.
```

## package/gst-felix/Config.in
```kconfig
comment "gst-felix depends on GStreamer"
	depends on !BR2_PACKAGE_GSTREAMER1

config BR2_PACKAGE_GST_FELIX
	bool "gst-felix"
	depends on BR2_PACKAGE_GSTREAMER1
	select BR2_PACKAGE_MCOM03_DMABUF_EXPORTER
	select BR2_PACKAGE_MCOM03_FELIX
	help
	  GStreamer plugin for Felix ISP

if BR2_PACKAGE_GST_FELIX

config BR2_PACKAGE_GST_FELIX_INSTALL_SRC
	bool "Build from source code"

endif
```

## package/isp-ddk/Config.in
```kconfig
menuconfig BR2_PACKAGE_ISP_DDK
	bool "isp-ddk"
	help
	  Build kernel driver, libraries and test
	  applications for PowerVR V2505 ISP.

if BR2_PACKAGE_ISP_DDK

config BR2_PACKAGE_ISP_DDK_ISPC_TEST
	bool "ispc_test"
	default y
	help
	  Install ISPC test.

config BR2_PACKAGE_ISP_DDK_ISPC_LOOP
	bool "ispc_loop"
	default y
	help
	  Install ISPC loop test.

config BR2_PACKAGE_ISP_DDK_DRIVER_TEST
	bool "driver_test"
	default y
	help
	  Install ISP driver test.
endif
```

## package/linux-starter/Config.in
```kconfig
config BR2_PACKAGE_LINUX_STARTER
	bool "linux-starter"
	help
	  Simple starter for MCom-03. Provides minimal
	  features to start Linux.
```

## package/mali-vpu-kern/Config.in
```kconfig
config BR2_PACKAGE_MALI_VPU_KERN
	bool "mali-vpu-kern"
	help
	  Linux kernel space driver for Mali VPU engine.

if BR2_PACKAGE_MALI_VPU_KERN

config BR2_PACKAGE_MALI_VPU_KERN_DEBUG
	bool "driver debug"
	help
	  This enabled debug output for the Mali VPU driver.

config BR2_PACKAGE_MALI_VPU_KERN_DISABLE_WDOG
	bool "disable watchdog"
	help
	  Disable the watchdog that detects frozen video sessions.

choice
	prompt "Choose power saving mode"
config BR2_PACKAGE_MALI_VPU_KERN_DVFS
	bool "Use DVFS"
config BR2_PACKAGE_MALI_VPU_KERN_CLOCK_GATING
	bool "Use HW clock gating"
endchoice

endif
```

## package/mali-vpu-libs/Config.in
```kconfig
config BR2_PACKAGE_MALI_VPU_LIBS
	bool "mali-vpu-libs"
	select BR2_PACKAGE_HAS_LIBOPENMAX
	select BR2_PACKAGE_JPEG
	select BR2_PACKAGE_JPEG_TURBO
	select BR2_PACKAGE_MALI_VPU_KERN
	help
	  Linux user space driver for Mali VPU engine.

if BR2_PACKAGE_MALI_VPU_LIBS

config BR2_PACKAGE_PROVIDES_LIBOPENMAX
	default "mali-vpu-libs"

endif
```

## package/mcom03-baremetal-tools-arm64/Config.in
```kconfig
config BR2_PACKAGE_MCOM03_BAREMETAL_TOOLS_ARM64
	bool "mcom03-baremetal-tools-arm64"
	help
	  Baremetal samples and tools suitable for
	  running on an ARM64 CPU of MCom-03 SoC.
```

## package/mcom03-baremetal-tools/Config.in
```kconfig
config BR2_PACKAGE_MCOM03_BAREMETAL_TOOLS
	bool "mcom03-baremetal-tools"
	depends on BR2_HOST_TOOLCHAIN_MIPSEL_ELVEES_ELF32
	help
	  Baremetal samples and tools suitable for running
	  on RISC0 CPU of MCom-03 SoC.
```

## package/mcom03-demos/Config.in
```kconfig
config BR2_PACKAGE_MCOM03_DEMOS
	bool "mcom03-demos"
	select BR2_PACKAGE_MPV
	help
	  Demo scripts for MCom-03
```

## package/mcom03-dmabuf-exporter/Config.in
```kconfig
config BR2_PACKAGE_MCOM03_DMABUF_EXPORTER
	bool "mcom03-dmabuf-exporter"
	depends on BR2_LINUX_KERNEL
	help
	  Exporter of DMA buffers for MCom-03

if BR2_PACKAGE_MCOM03_DMABUF_EXPORTER

config BR2_PACKAGE_MCOM03_DMABUF_EXPORTER_AUTOLOAD
	bool "Autoload dmabuf_exporter.ko"
	default y
	depends on BR2_PACKAGE_SYSTEMD

comment "mcom03-dmabuf-exporter needs systemd for automatic loading"
	depends on !BR2_PACKAGE_SYSTEMD

endif
```

## package/mcom03-felix/Config.in
```kconfig
config BR2_PACKAGE_MCOM03_FELIX
	bool "mcom03-felix"
	depends on BR2_LINUX_KERNEL
	select BR2_PACKAGE_LIBGPIOD
	select BR2_PACKAGE_SENSOR_PHY
	help
	  Build kernel driver, libraries and test
	  applications for PowerVR V2505 ISP.

if BR2_PACKAGE_MCOM03_FELIX

config BR2_PACKAGE_MCOM03_FELIX_LINUX_VERSION
	string "Linux kernel version for Felix"
	help
	  The Linux version for which Felix library will be exported
	  or imported.

config BR2_PACKAGE_MCOM03_FELIX_INSTALL_SRC
	bool "Build from source"
	help
	  Build mcom03-felix package from the source code.

comment "The options below have no effect unless \"Build from source\" or OVERRIDE_SRCDIR"
	depends on !BR2_PACKAGE_MCOM03_FELIX_INSTALL_SRC

comment "mcom03-dmabuf-exporter is required for dmabuf support"
	depends on !BR2_PACKAGE_MCOM03_DMABUF_EXPORTER

config BR2_PACKAGE_MCOM03_FELIX_ISPC_TEST
	bool "felix-ispc-test"
	default y
	help
	  Install ISPC test.

config BR2_PACKAGE_MCOM03_FELIX_ISPC_LOOP
	bool "felix-ispc-loop"
	default y
	help
	  Install ISPC loop test.

comment "felix-ispc-loop w/ display output support needs libdrm"
	depends on !BR2_PACKAGE_LIBDRM

config BR2_PACKAGE_MCOM03_FELIX_DRIVER_TEST
	bool "felix-driver-test"
	default y
	help
	  Install ISP driver test.

config BR2_PACKAGE_MCOM03_FELIX_SENSOR_TEST
	bool "felix-sensor-test"
	default y
	help
	  Install ISP sensor test.

config BR2_PACKAGE_MCOM03_FELIX_I2C_TEST
	bool "felix-i2c-test"
	default y
	help
	  Install ISP i2c test.

config BR2_PACKAGE_MCOM03_FELIX_FOCUS_TEST
	bool "felix-focus-test"
	default y
	help
	  Install ISP focus test.

config BR2_PACKAGE_MCOM03_FELIX_SENSOR_MODES
	bool "felix-sensor-modes"
	default y
	help
	  Install ISP sensor modes printing tool.

config BR2_PACKAGE_MCOM03_FELIX_SENSOR_OV2718
	bool "OV2718 support"
	default y
	help
	  Support OV2718 sensor

config BR2_PACKAGE_MCOM03_FELIX_SENSOR_OV4689
	bool "OV4689 support"
	default y
	help
	  Support OV4689 sensor

config BR2_PACKAGE_MCOM03_FELIX_SENSOR_OV5647
	bool "OV5647 support"
	default y
	help
	  Support OV5647 sensor

config BR2_PACKAGE_MCOM03_FELIX_SENSOR_OV10823
	bool "OV10823 support"
	default y
	help
	  Support OV10823 sensor

config BR2_PACKAGE_MCOM03_FELIX_SENSOR_PARAXDMA_LINUX
	bool "PARAXDMA support"
	help
	  Support PARAXDMA sensor on HAPS

endif
```
